## CMakeLists.txt
```
# Copyright (c) 2026 Hubert Włodarczyk
# SPDX-License-Identifier: MPL-2.0

cmake_minimum_required(VERSION 3.20.0)

find_package(Zephyr REQUIRED HINTS $ENV{ZEPHYR_BASE})
project(leabench)

target_sources(app PRIVATE
  src/main.c
  src/sys_cmds.c
  src/radio_cmds.c
  src/human_evt.c
  src/cli_table.c
  src/dev.c
  src/dev_cmds.c
  src/dev_link_cmds.c
  src/audio_tx.c
  src/lc3_frames.c
  src/phone.c
  src/phone_cmds.c
  src/unicast.c
  src/call.c
  src/media.c
  src/volume.c
  src/remotectl.c
  src/bcast/model.c
  src/bcast/budget.c
  src/bcast/source.c
  src/bcast/args.c
  src/bcast/validate.c
  src/bcast/cmds.c
  src/bcast/run_cmds.c
  src/presets.c
  ../common/src/cli_out.c
  ../common/src/cli_evt.c
  ../common/src/cli_parse.c
  ../common/src/cli_tree.c
  ../common/src/hci_util.c
)

# Real board only: application core at 128 MHz
if(CONFIG_BOARD_NRF5340DK)
  target_sources(app PRIVATE src/board.c)
endif()

target_include_directories(app PRIVATE
  src
  ../common/include
)
```

## Kconfig
```
mainmenu "LEA Bench"

menu "LEA Bench limits"

config LEA_BCAST_MAX_BIGS
	int "Broadcast sources (BIGs) that can exist at the same time"
	range 1 3
	default 3
	help
	  Separate BIGs are needed for streams that differ in BIG-level parameters
	  (encryption, PHY, frame duration / ISO interval, RTN). Must not exceed
	  BT_CTLR_ADV_ISO_SET of the controller image (leabench/netcore.conf).
	  The air time budget allows at most 3 BIGs (each costs ~2.4 ms of every
	  10 ms besides its BISes).

config LEA_BCAST_MAX_SUBGROUPS
	int "Subgroups per broadcast source"
	range 1 8
	default 4

config LEA_BCAST_MAX_BIS
	int "BISes per broadcast source"
	range 1 8
	default 8
	help
	  Must not exceed BT_CTLR_ADV_ISO_STREAM_MAX of the controller image
	  (leabench/netcore.conf). Air time is the practical limit: see 'bcast show'.

config LEA_BCAST_MAX_BIS_TOTAL
	int "BISes of all broadcasts together"
	range 1 16
	default 16
	help
	  Must match BT_CTLR_ADV_ISO_STREAM_COUNT of the controller image
	  (leabench/netcore.conf); 16 is what the 64 KB RAM of the nRF5340 network
	  core allows with the trimmed controller.

endmenu

configdefault BT_ISO_MAX_BIG
	default LEA_BCAST_MAX_BIGS

configdefault BT_BAP_BROADCAST_SRC_COUNT
	default LEA_BCAST_MAX_BIGS

configdefault BT_BAP_BROADCAST_SRC_SUBGROUP_COUNT
	default LEA_BCAST_MAX_SUBGROUPS

configdefault BT_BAP_BROADCAST_SRC_STREAM_COUNT
	default LEA_BCAST_MAX_BIS

source "Kconfig.zephyr"
```

## Kconfig.sysbuild
```
source "share/sysbuild/Kconfig"

config NET_CORE_BOARD
	string
	default "nrf5340dk/nrf5340/cpunet" if "$(BOARD)" = "nrf5340dk"
	default "nrf5340_audio_dk/nrf5340/cpunet" if "$(BOARD)" = "nrf5340_audio_dk"
	default "nrf5340bsim/nrf5340/cpunet" if $(BOARD_TARGET_STRING) = "NRF5340BSIM_NRF5340_CPUAPP"

config NET_CORE_IMAGE_HCI_IPC
	bool "HCI IPC image on network core"
	default y
	depends on NET_CORE_BOARD != ""
```

## prj.conf
```kconfig
# --- CLI (machine-parsable, no prompt/echo/colors) ---
CONFIG_SERIAL=y
# Interrupt driven in the simulation; the DK uses the async (DMA) API (boards/)
CONFIG_SHELL=y
CONFIG_SHELL_BACKEND_SERIAL=y
CONFIG_SHELL_PROMPT_UART=""
CONFIG_SHELL_ECHO_STATUS=n
CONFIG_SHELL_VT100_COLORS=n
CONFIG_SHELL_VT100_COMMANDS=n
CONFIG_SHELL_LOG_BACKEND=n
CONFIG_SHELL_STACK_SIZE=4096
CONFIG_SHELL_CMD_BUFF_SIZE=256
CONFIG_SHELL_ARGC_MAX=24

CONFIG_LOG=y
CONFIG_MAIN_STACK_SIZE=4096
CONFIG_SYSTEM_WORKQUEUE_STACK_SIZE=2048
# No LC3 encoder and no floating point: tones are precomputed frames (src/lc3_frames.c)
CONFIG_UTF8=y

# --- Bluetooth host ---
CONFIG_BT=y
CONFIG_BT_DEVICE_NAME="LEA Bench"
CONFIG_BT_CENTRAL=y
CONFIG_BT_PERIPHERAL=y
CONFIG_BT_SMP=y
CONFIG_BT_GATT_CLIENT=y
CONFIG_BT_GATT_DYNAMIC_DB=y
CONFIG_BT_GATT_AUTO_DISCOVER_CCC=y
CONFIG_BT_GATT_AUTO_UPDATE_MTU=y
CONFIG_BT_EXT_ADV=y
CONFIG_BT_PER_ADV=y
# One advertising set (extended + periodic) per broadcast
CONFIG_BT_EXT_ADV_MAX_ADV_SET=3
CONFIG_BT_MAX_CONN=3
# Virtual devices: one identity each (identity 0 is the tool itself)
CONFIG_BT_ID_MAX=9
CONFIG_BT_MAX_PAIRED=16
# Virtual devices use resolvable private addresses like real phones; each identity has its own
# IRK and every connection attempt a fresh RPA. Build with -DCONFIG_BT_PRIVACY=n for fixed
# (identity) addresses, e.g. for a sniffer.
CONFIG_BT_PRIVACY=y
CONFIG_BT_ATT_TX_COUNT=12
CONFIG_BT_L2CAP_TX_BUF_COUNT=20

# --- LE Audio ---
CONFIG_BT_AUDIO=y
CONFIG_BT_ISO_CENTRAL=y
CONFIG_BT_ISO_BROADCASTER=y
# ISO TX buffers: as many as the controller has (leabench/netcore.conf).
# Channels: the BISes of all broadcasts (LEA_BCAST_MAX_BIS_TOTAL) + 2 CIS (BUILD_ASSERT in
# src/bcast/internal.h)
CONFIG_BT_ISO_MAX_CHAN=18
CONFIG_BT_ISO_TX_BUF_COUNT=17
CONFIG_BT_ISO_TX_MTU=155
CONFIG_BT_CAP_INITIATOR=y
CONFIG_BT_CSIP_SET_COORDINATOR=y
CONFIG_BT_BAP_UNICAST_CLIENT=y
CONFIG_BT_BAP_UNICAST_CLIENT_GROUP_STREAM_COUNT=2
CONFIG_BT_BAP_UNICAST_CLIENT_ASE_SNK_COUNT=2
CONFIG_BT_BAP_UNICAST_CLIENT_ASE_SRC_COUNT=2
CONFIG_BT_BAP_BROADCAST_SOURCE=y
# Broadcast source counts are derived from LEA_BCAST_* in leabench/Kconfig
CONFIG_BT_AUDIO_CODEC_CFG_MAX_METADATA_SIZE=32
CONFIG_BT_PBP=y

# Phone side: call control (TBS), media control (MCS), volume control (VCP)
CONFIG_BT_TBS=y
CONFIG_BT_CCP_CALL_CONTROL_SERVER=y
CONFIG_BT_MCS=y
CONFIG_BT_MPL=y
CONFIG_MCTL=y
CONFIG_MCTL_LOCAL_PLAYER_CONTROL=y
CONFIG_MCTL_LOCAL_PLAYER_REMOTE_CONTROL=y
CONFIG_BT_VCP_VOL_CTLR=y

# --- No flash writes: identities, bonds and names live in RAM only. Without a flash driver
# writing is impossible; an automated test loop would wear the flash out in minutes. ---
CONFIG_FLASH=n
CONFIG_SETTINGS=n
CONFIG_BT_SETTINGS=n

# Link parameter control from the CLI
CONFIG_BT_USER_PHY_UPDATE=y
CONFIG_BT_USER_DATA_LEN_UPDATE=y

# Device controls (companion app): presets, microphone, balance
CONFIG_BT_HAS_CLIENT=y
CONFIG_BT_MICP_MIC_CTLR=y
CONFIG_BT_AICS_CLIENT_MAX_INSTANCE_COUNT=1
CONFIG_BT_MICP_MIC_CTLR_MAX_AICS_INST=1
CONFIG_BT_VOCS_CLIENT_MAX_INSTANCE_COUNT=1
CONFIG_BT_VCP_VOL_CTLR_MAX_VOCS_INST=1

# Client support: unique chip id ('id'), runtime prompt for 'proto human'
CONFIG_HWINFO=y
CONFIG_SHELL_PROMPT_CHANGE=y
# 'help' comes from the protocol specification (cli_tree.c), not the shell's built-in one
CONFIG_SHELL_HELP_CMD=n

# Bluetooth RX thread: the host's path to a callback plus our callbacks (scripts/stack_report.py:
# ~1.3 KB below a callback, cbprintf through pointers on top). 2048 overflowed on the board; the
# simulation runs threads on host stacks and cannot show it.
CONFIG_BT_RX_STACK_SIZE=3072
```

## diag.conf
```kconfig
# Copyright (c) 2026 Hubert Włodarczyk
# SPDX-License-Identifier: MPL-2.0

# Diagnostic build (scripts/build.sh dk --diag): measures the real stack use on the DK.
#   kernel thread stacks   used / size of every thread stack (stacks are filled at boot)
#   kernel thread list     threads and their state
# Run a full scenario (max broadcast, phone call, pairing), then read the maxima and size the
# stacks in prj.conf / the K_THREAD_DEFINEs to the measured value + 25 %.
CONFIG_KERNEL_SHELL=y
CONFIG_INIT_STACKS=y
CONFIG_THREAD_STACK_INFO=y
CONFIG_THREAD_MONITOR=y
CONFIG_THREAD_NAME=y

# Automatic stack report: every 10 s every thread's used / size goes to the RTT log, so a test
# run on the board shows which stack runs short without typing anything (the simulation cannot:
# its threads run on host stacks). Canaries catch overflows of locals the MPU guard misses.
CONFIG_THREAD_ANALYZER=y
CONFIG_THREAD_ANALYZER_AUTO=y
CONFIG_THREAD_ANALYZER_AUTO_INTERVAL=10
CONFIG_THREAD_ANALYZER_USE_LOG=y
CONFIG_STACK_CANARIES=y
```

## netcore.conf
```kconfig
# Bluetooth controller (Zephyr LL, hci_ipc) of leabench on the nRF5340 network core (64 KB RAM).
# Replaces the sample's extra-iso-bt_ll_sw_split.conf, which enables every role: only what
# leabench uses is kept, and the RAM goes to broadcast (BIGs / BISes).
#
#   kept:     central + CIS central (dev, phone), scanning to connect, broadcaster (extended +
#             periodic advertising + BIG, encrypted BIGs), coded PHY, TX power control
#   dropped:  peripheral (+ ISO), BIG reception, periodic sync, PAST, DTM, big scan buffers
#
# A CIS never runs at the same time as a BIG (leabench modes), so the ISO data paths and TX
# buffers are shared. The *_COUNT values below must match LEA_BCAST_* in leabench/Kconfig.

# Stacks and heap (heap: PSA key derivation of encrypted BIGs)
CONFIG_ISR_STACK_SIZE=1536
CONFIG_IDLE_STACK_SIZE=256
# main: hci_ipc forwards controller events over IPC (0.42 KB direct, the IPC backend through
# pointers on top); sysworkq as much headroom (scripts/stack_report.py)
CONFIG_MAIN_STACK_SIZE=1024
CONFIG_SYSTEM_WORKQUEUE_STACK_SIZE=1024
# Heap users: the IPC virtqueues at boot and AES-CMAC (encrypted BIG keys); 1 KB is plenty
CONFIG_HEAP_MEM_POOL_SIZE=1024
CONFIG_CBPRINTF_REDUCED_INTEGRAL=y
CONFIG_ISR_TABLES_LOCAL_DECLARATION=y
CONFIG_LTO=y

# HCI buffers: commands and events are small, ACL only for GATT of the virtual devices
CONFIG_BT_BUF_CMD_TX_SIZE=255
CONFIG_BT_BUF_EVT_RX_COUNT=6
CONFIG_BT_BUF_EVT_RX_SIZE=255
CONFIG_BT_BUF_ACL_TX_COUNT=3
CONFIG_BT_BUF_ACL_TX_SIZE=251
CONFIG_BT_BUF_ACL_RX_COUNT_EXTRA=1
CONFIG_BT_BUF_ACL_RX_SIZE=255

# Roles
CONFIG_BT_BROADCASTER=y
CONFIG_BT_OBSERVER=y
CONFIG_BT_EXT_ADV=y
CONFIG_BT_PER_ADV=y
CONFIG_BT_CENTRAL=y
CONFIG_BT_PERIPHERAL=n
CONFIG_BT_MAX_CONN=3
CONFIG_BT_ISO_BROADCASTER=y
CONFIG_BT_ISO_CENTRAL=y

# ISO data over HCI: one SDU per stream in flight per buffer (see BT_CTLR_ISO_TX_BUFFERS)
CONFIG_BT_ISO_TX_MTU=155
CONFIG_BT_ISO_MAX_CHAN=4

CONFIG_BT_LL_SW_SPLIT=y
CONFIG_BT_CTLR_DTM_HCI=n
CONFIG_BT_CTLR_ASSERT_HANDLER=y
CONFIG_BT_HCI_VS_FATAL_ERROR=y

CONFIG_BT_CTLR_RX_BUFFERS=3
CONFIG_BT_CTLR_DATA_LENGTH_MAX=251
CONFIG_BT_CTLR_PHY_CODED=y

# Advertising: one extended + periodic set per BIG (3 BIGs, no spare: a set is deleted before its
# BIG starts again); data buffers: one update per BIG in flight
CONFIG_BT_CTLR_ADV_EXT=y
CONFIG_BT_CTLR_ADV_DATA_LEN_MAX=191
CONFIG_BT_CTLR_SCAN_DATA_LEN_MAX=255
CONFIG_BT_CTLR_ADVANCED_FEATURES=y
CONFIG_BT_CTLR_ADV_AUX_PDU_BACK2BACK=y
CONFIG_BT_CTLR_ADV_SYNC_PDU_BACK2BACK=y
CONFIG_BT_CTLR_ADV_DATA_BUF_MAX=2
CONFIG_BT_CTLR_SCAN_AUX_SET=1
CONFIG_BT_CTLR_LOW_LAT_ULL=y

CONFIG_BT_CTLR_ADV_RESERVE_MAX=n
CONFIG_BT_CTLR_ADV_ISO_RESERVE_MAX=y
CONFIG_BT_CTLR_CENTRAL_RESERVE_MAX=n
CONFIG_BT_CTLR_EVENT_OVERHEAD_RESERVE_MAX=n
CONFIG_BT_CTLR_SLOT_RESERVATION_UPDATE=n
CONFIG_BT_CTLR_SCAN_UNRESERVED=y
CONFIG_BT_TICKER_NEXT_SLOT_GET_MATCH=y
CONFIG_BT_TICKER_EXT=y
CONFIG_BT_TICKER_EXT_SLOT_WINDOW_YIELD=y
CONFIG_BT_CTLR_LLCP_LOCAL_PROC_CTX_BUF_NUM=4

# ISO broadcaster (encrypted BIGs: CCM by the radio, keys derived once per BIG)
CONFIG_BT_CTLR_ADV_PERIODIC=y
CONFIG_BT_CTLR_ADV_ISO=y
CONFIG_BT_CTLR_ADV_ISO_SEQUENTIAL=y
CONFIG_BT_CTLR_ADV_ISO_INTERLEAVED=y
CONFIG_BT_CTLR_ADV_ISO_PDU_LEN_MAX=160
CONFIG_BT_CTLR_ADV_ISO_SET=3
CONFIG_BT_CTLR_ADV_SET=3
CONFIG_BT_CTLR_ADV_AUX_SET=3
CONFIG_BT_CTLR_ADV_SYNC_SET=3
CONFIG_BT_CTLR_ADV_ISO_STREAM_MAX=8
CONFIG_BT_CTLR_ADV_ISO_STREAM_COUNT=16

# Connected ISO: the phone's unicast audio (one sink + one source CIS)
CONFIG_BT_CTLR_CENTRAL_ISO=y
CONFIG_BT_CTLR_CONN_ISO_GROUPS=1
CONFIG_BT_CTLR_CONN_ISO_STREAMS=2
CONFIG_BT_CTLR_CONN_ISO_STREAMS_PER_GROUP=2
CONFIG_BT_CTLR_CONN_ISO_LOW_LATENCY_POLICY=y

# ISO TX: SDUs up to 155 octets (48_6), 2 per stream in flight
CONFIG_BT_CTLR_ISOAL_SOURCES=16
CONFIG_BT_CTLR_ISO_TX_BUFFERS=17
CONFIG_BT_ISO_TX_BUF_COUNT=17
# The BIS PDU is limited to min(ADV_ISO_PDU_LEN_MAX, ISO_TX_BUFFER_SIZE - 8): the buffer also holds
# the 8 octet SDU timestamp header. With 160 a 155 octet 48_6 SDU was split into 2 PDUs (BN=2):
# twice the air time and only 4 BISes per BIG (scripts/capacity.py accept).
CONFIG_BT_CTLR_ISO_TX_BUFFER_SIZE=163
CONFIG_BT_CTLR_ISO_TX_SDU_LEN_MAX=155

# ISO RX: the phone's microphone stream (source CIS)
CONFIG_BT_ISO_RX_MTU=160
CONFIG_BT_ISO_RX_BUF_COUNT=1
CONFIG_BT_CTLR_ISOAL_SINKS=1
CONFIG_BT_CTLR_ISO_RX_BUFFERS=2

CONFIG_BT_CTLR_TX_PWR_DYNAMIC_CONTROL=y

# PSA crypto only for AES-CMAC (encrypted BIG key derivation): CSPRNG, ROM tables, 3 key slots
CONFIG_MBEDTLS_PSA_CRYPTO_EXTERNAL_RNG=y
CONFIG_MBEDTLS_AES_ROM_TABLES=y
CONFIG_MBEDTLS_PSA_KEY_SLOT_COUNT=3

# No pre-transmission subevents: BIG events only as long as BISes x (RTN+1) (Zephyr patch 0003);
# lets 4 BIGs share the 10 ms interval. Repetition is set per BIG with rtn= instead.
CONFIG_BT_CTLR_ADV_ISO_PTO_GROUP_COUNT=0

# HCI command thread, sized with scripts/stack_report.py (no LTO): it runs LE Create BIG (patch
# 0006 phase search: ~0.96 KB) and Read Schedule (patch 0013). The controller's RX thread is a
# hidden option (896, ~0.71 KB measured), the same as in the upstream hci_ipc sample.
CONFIG_BT_HCI_TX_STACK_SIZE_WITH_PROMPT=y
CONFIG_BT_HCI_TX_STACK_SIZE=1792
```

## boards/nrf5340dk_nrf5340_cpuapp.overlay
```dts
/* CLI on the J-Link VCOM at 1 Mbaud: an EVT line takes ~1 ms instead of ~9 ms at 115200 */
&uart0 {
	current-speed = <1000000>;
};
```

## src/main.c
```c
/*
 * Copyright (c) 2026 Hubert Włodarczyk
 *
 * SPDX-License-Identifier: MPL-2.0
 */

#include <zephyr/bluetooth/bluetooth.h>
#include <zephyr/kernel.h>
#include <zephyr/logging/log.h>

#include "version.h"
#include "dev.h"
#include "audio_tx.h"
#include "phone.h"
#include "bcast.h"
#include "cli.h"

LOG_MODULE_REGISTER(main, LOG_LEVEL_INF);

int main(void)
{
	bt_addr_le_t addr;
	size_t count = 1;
	char addr_str[CLI_ADDR_STR_LEN];
	int err;

	err = bt_enable(NULL);
	if (err != 0) {
		LOG_ERR("Bluetooth init failed: %d", err);
		cli_evt("fatal", "reason=bt_enable err=%d", err);
		return 0;
	}

	/* No settings_load(): nothing is ever written to flash, every boot starts empty */
	err = dev_init();
	err = err ?: audio_tx_init();
	err = err ?: phone_init();
	err = err ?: bcast_init();
	if (err != 0) {
		LOG_ERR("Module init failed: %d", err);
		cli_evt("fatal", "reason=init err=%d", err);
		return 0;
	}

	bt_id_get(&addr, &count);
	cli_addr_str(&addr, addr_str, sizeof(addr_str));
	LOG_INF("LEA Bench %s ready, identity %s", LEABENCH_VERSION, addr_str);
	cli_evt("ready", "app=leabench version=%s proto=%d addr=%s identities=%u", LEABENCH_VERSION,
		LEABENCH_PROTO, addr_str, dev_count());

	return 0;
}
```

## src/audio_tx.c
```c
/*
 * Copyright (c) 2026 Hubert Włodarczyk
 *
 * SPDX-License-Identifier: MPL-2.0
 */

/*
 * Feeds sine tones to ISO streams (unicast sink ASEs and broadcast BISes) from the precomputed
 * LC3 frame table (lc3_frames.c): no encoder, no DSP. A tone is a short cycle of frames sent in
 * a loop; its level is set by rewriting the global gain field of each frame. Each stream keeps
 * at most TX_INFLIGHT (1 with many streams) SDUs queued in the controller; the `sent` callback
 * releases a slot.
 */

#include <errno.h>
#include <string.h>

#include <zephyr/bluetooth/audio/audio.h>
#include <zephyr/bluetooth/audio/bap.h>
#include <zephyr/bluetooth/audio/cap.h>
#include <zephyr/bluetooth/iso.h>
#include <zephyr/kernel.h>
#include <zephyr/logging/log.h>
#include <zephyr/net_buf.h>

#include "audio_tx.h"
#include "lc3_frames.h"

LOG_MODULE_REGISTER(audio_tx, LOG_LEVEL_INF);

/* Every broadcast BIS plus the unicast sink stream */
#define TX_SLOTS      (CONFIG_LEA_BCAST_MAX_BIS_TOTAL + 1)
#define TX_INFLIGHT   2
/* The TX thread also wakes up on its own, to retry after a full buffer pool */
#define TX_POLL       K_MSEC(5)
/* ISO TX buffers of the controller (BT_CTLR_ISO_TX_BUFFERS = host BT_ISO_TX_BUF_COUNT): with
 * more streams than half of them, 2 SDUs per stream in flight would starve some streams, so
 * each stream gets 1 (the next SDU follows its `sent` callback, well within the interval).
 */
#define CTLR_ISO_BUFS CONFIG_BT_ISO_TX_BUF_COUNT

#define TX_BUFS (TX_SLOTS * TX_INFLIGHT)

/* Every frame of the table fits into one ISO SDU */
BUILD_ASSERT(LC3_TAB_MAX_OCTETS <= CONFIG_BT_ISO_TX_MTU, "raise CONFIG_BT_ISO_TX_MTU");

NET_BUF_POOL_FIXED_DEFINE(tx_pool, TX_BUFS, BT_ISO_SDU_BUF_SIZE(CONFIG_BT_ISO_TX_MTU),
			  CONFIG_BT_CONN_TX_USER_DATA_SIZE, NULL);

struct tx_slot {
	struct bt_cap_stream *stream;
	struct tone tone;
	const struct lc3_tab_cfg *cfg;
	const uint8_t *frames; /* cycle of the tone, NULL: silence */
	uint8_t nframes;
	int16_t gain_delta; /* added to the global gain of every frame */
	uint8_t depth;      /* SDUs in flight for this stream, 0: inflight_max() */
	uint16_t seq_num;
	uint32_t frame_count;
	uint32_t sent_count;
	int inflight;
};

/*
 * slots_lock (mutex): held by the TX thread while sending and by start/stop/set_tone.
 * bind_lock (spinlock): protects stream, inflight and sent_count, which are also touched from the
 * Bluetooth `sent` callback; that callback must never wait for the mutex.
 */
static struct tx_slot slots[TX_SLOTS];
static K_MUTEX_DEFINE(slots_lock);
static struct k_spinlock bind_lock;
static K_SEM_DEFINE(tx_sem, 0, 1);

/* --- Frame table --- */

const struct lc3_tab_cfg *audio_cfg_find(uint32_t sr_hz, uint32_t frame_us, uint16_t octets)
{
	for (size_t i = 0; i < ARRAY_SIZE(lc3_tab); i++) {
		if (lc3_tab[i].sr_hz == sr_hz && lc3_tab[i].frame_us == frame_us &&
		    lc3_tab[i].octets == octets) {
			return &lc3_tab[i];
		}
	}

	return NULL;
}

/* Tone m has the frequency m * sr / (cycle * samples) */
static uint32_t tone_mhz(const struct lc3_tab_cfg *cfg, uint32_t m)
{
	const uint64_t div = (uint64_t)cfg->cycle * cfg->samples;

	return (uint32_t)(((uint64_t)m * cfg->sr_hz * 1000U + div / 2U) / div);
}

int audio_tone_resolve(const struct lc3_tab_cfg *cfg, uint32_t freq_hz, bool exact,
		       uint32_t *actual_mhz)
{
	const uint32_t div = cfg->cycle * cfg->samples;
	uint32_t m;

	if (freq_hz == 0U) {
		*actual_mhz = 0;
		return 0;
	}

	m = (uint32_t)(((uint64_t)freq_hz * div + cfg->sr_hz / 2U) / cfg->sr_hz);
	if (m < cfg->m_min || m > cfg->m_max) {
		return -ERANGE;
	}

	*actual_mhz = tone_mhz(cfg, m);
	if (exact && *actual_mhz != freq_hz * 1000U) {
		return -EINVAL;
	}

	return (int)m;
}

void audio_tone_range(const struct lc3_tab_cfg *cfg, uint32_t *min_hz, uint32_t *max_hz,
		      uint32_t *step_mhz)
{
	*min_hz = (tone_mhz(cfg, cfg->m_min) + 999U) / 1000U;
	*max_hz = tone_mhz(cfg, cfg->m_max) / 1000U;
	*step_mhz = tone_mhz(cfg, 1);
}

/* Global gain steps of 20/28 dB: level_db * 1.4, rounded */
static int16_t level_to_delta(int8_t level_db)
{
	const int x = level_db * 14;

	return (int16_t)(x >= 0 ? (x + 5) / 10 : (x - 5) / 10);
}

int audio_level_actual_cdb(int8_t level_db)
{
	const int x = level_to_delta(level_db) * 2000;

	return x >= 0 ? (x + 14) / 28 : (x - 14) / 28;
}

const char *audio_cfg_names(void)
{
	return "8_1 8_2 16_1 16_2 24_1 24_2 32_1 32_2 441_1 441_2 48_1..48_6";
}

/* Writes the 8 bit global gain at `bit` (LSB first, counted from the end of the frame) */
static void patch_gain(uint8_t *frame, uint16_t len, uint8_t bit, int16_t delta)
{
	unsigned int v = 0;
	int g;

	for (int i = 0; i < 8; i++) {
		const unsigned int b = bit + i;

		v |= ((frame[len - 1U - b / 8U] >> (b % 8U)) & 1U) << i;
	}

	g = CLAMP((int)v + delta, 0, 255);

	for (int i = 0; i < 8; i++) {
		const unsigned int b = bit + i;
		uint8_t *p = &frame[len - 1U - b / 8U];

		*p = (*p & ~BIT(b % 8U)) | (((g >> i) & 1) << (b % 8U));
	}
}

/* Selects the frames of slot->tone; slots_lock held */
static void slot_load(struct tx_slot *slot)
{
	uint32_t actual, min_hz, max_hz, step;
	int m;

	/* Validated by the CLI for broadcasts; a unicast configuration is only known after the
	 * negotiation, so its tone is capped to the table's range.
	 */
	audio_tone_range(slot->cfg, &min_hz, &max_hz, &step);
	m = audio_tone_resolve(slot->cfg,
			       slot->tone.freq_hz == 0U ? 0U
							: CLAMP(slot->tone.freq_hz, min_hz, max_hz),
			       false, &actual);

	slot->frames = NULL;
	slot->nframes = 1;
	slot->frame_count = 0;
	slot->gain_delta = level_to_delta(slot->tone.level_db);

	if (m > 0) {
		const uint32_t i = m - slot->cfg->m_min;
		const uint32_t len = slot->cfg->offs[i + 1] - slot->cfg->offs[i];

		slot->frames = &slot->cfg->blob[slot->cfg->offs[i]];
		slot->nframes = len / slot->cfg->octets;
	}
}

static struct tx_slot *find_slot(const struct bt_cap_stream *stream)
{
	for (size_t i = 0; i < ARRAY_SIZE(slots); i++) {
		if (slots[i].stream == stream) {
			return &slots[i];
		}
	}

	return NULL;
}

static bool tone_on(const struct tx_slot *slot)
{
	/* 64 bit: frame_count * frame_us passes 2^32 after 71 minutes of 10 ms frames */
	const uint32_t t_ms =
		(uint32_t)(((uint64_t)slot->frame_count * slot->cfg->frame_us) / 1000U);

	switch (slot->tone.pattern) {
	case TONE_RING:
		return (t_ms % 2000U) < 1000U;
	case TONE_BEEP:
		return (t_ms % 200U) < 100U;
	case TONE_CONTINUOUS:
	default:
		return true;
	}
}

static void send_one(struct tx_slot *slot)
{
	const uint16_t octets = slot->cfg->octets;
	struct net_buf *buf;
	uint8_t *out;
	int err;

	buf = net_buf_alloc(&tx_pool, K_NO_WAIT);
	if (buf == NULL) {
		return;
	}

	net_buf_reserve(buf, BT_ISO_CHAN_SEND_RESERVE);
	out = net_buf_add(buf, octets);

	if (slot->frames != NULL && tone_on(slot)) {
		memcpy(out, slot->frames + (slot->frame_count % slot->nframes) * octets, octets);
		if (slot->gain_delta != 0) {
			patch_gain(out, octets, slot->cfg->gidx_bit, slot->gain_delta);
		}
	} else {
		memcpy(out, slot->cfg->silence, octets);
	}

	K_SPINLOCK(&bind_lock) {
		slot->inflight++;
	}

	err = bt_cap_stream_send(slot->stream, buf, slot->seq_num);
	if (err != 0) {
		LOG_DBG("send failed: %d", err);
		K_SPINLOCK(&bind_lock) {
			slot->inflight--;
		}
		net_buf_unref(buf);
		return;
	}

	/* Only a frame that was queued advances the tone: after a failed send the same frame goes
	 * next, so the tone keeps its phase (skipping one frame of a 2-frame cycle inverts it).
	 */
	slot->frame_count++;
	slot->seq_num++;
}

static int inflight_max(void)
{
	int active = 0;

	K_SPINLOCK(&bind_lock) {
		for (size_t i = 0; i < ARRAY_SIZE(slots); i++) {
			active += slots[i].stream != NULL;
		}
	}

	return active * TX_INFLIGHT <= CTLR_ISO_BUFS ? TX_INFLIGHT : 1;
}

/* SDUs of the slot in flight; "full" for an unbound slot */
static int inflight(const struct tx_slot *slot)
{
	int n = 0;

	K_SPINLOCK(&bind_lock) {
		n = slot->stream != NULL ? slot->inflight : TX_INFLIGHT;
	}

	return n;
}

static void tx_thread(void *p1, void *p2, void *p3)
{
	ARG_UNUSED(p1);
	ARG_UNUSED(p2);
	ARG_UNUSED(p3);

	while (true) {
		k_mutex_lock(&slots_lock, K_FOREVER);
		const int dflt = inflight_max();

		for (size_t i = 0; i < ARRAY_SIZE(slots); i++) {
			struct tx_slot *slot = &slots[i];
			const int max = slot->depth > 0U ? slot->depth : dflt;

			while (inflight(slot) < max) {
				const int before = inflight(slot);

				send_one(slot);
				if (inflight(slot) <= before) {
					break; /* no buffer or send error, retry later */
				}
			}
		}
		k_mutex_unlock(&slots_lock);

		(void)k_sem_take(&tx_sem, TX_POLL);
	}
}

K_THREAD_STACK_DEFINE(tx_stack, 1024);
static struct k_thread tx_thread_data;

int audio_tx_init(void)
{
	k_thread_create(&tx_thread_data, tx_stack, K_THREAD_STACK_SIZEOF(tx_stack), tx_thread, NULL,
			NULL, NULL, K_PRIO_PREEMPT(4), 0, K_NO_WAIT);
	k_thread_name_set(&tx_thread_data, "audio_tx");

	return 0;
}

int audio_tx_start(struct bt_cap_stream *stream, const struct tone *tone)
{
	const struct bt_audio_codec_cfg *codec = stream->bap_stream.codec_cfg;
	const struct lc3_tab_cfg *cfg;
	struct tx_slot *slot;
	int freq, dur, octets;

	if (codec == NULL) {
		return -EINVAL;
	}

	freq = bt_audio_codec_cfg_get_freq(codec);
	dur = bt_audio_codec_cfg_get_frame_dur(codec);
	octets = bt_audio_codec_cfg_get_octets_per_frame(codec);
	if (freq < 0 || dur < 0 || octets <= 0) {
		return -EINVAL;
	}

	cfg = audio_cfg_find(bt_audio_codec_cfg_freq_to_freq_hz(freq),
			     bt_audio_codec_cfg_frame_dur_to_frame_dur_us(dur), octets);
	if (cfg == NULL) {
		LOG_WRN("No frames for %d Hz / %d us / %d octets",
			bt_audio_codec_cfg_freq_to_freq_hz(freq),
			bt_audio_codec_cfg_frame_dur_to_frame_dur_us(dur), octets);
		return -ENOTSUP;
	}

	k_mutex_lock(&slots_lock, K_FOREVER);

	slot = find_slot(stream);
	if (slot == NULL) {
		slot = find_slot(NULL);
	}

	if (slot == NULL) {
		k_mutex_unlock(&slots_lock);
		return -ENOMEM;
	}

	K_SPINLOCK(&bind_lock) {
		slot->stream = NULL;
	}

	memset(slot, 0, sizeof(*slot));
	slot->cfg = cfg;
	slot->tone = *tone;
	slot_load(slot);

	K_SPINLOCK(&bind_lock) {
		slot->inflight = 0;
		slot->stream = stream;
	}
	k_mutex_unlock(&slots_lock);

	LOG_INF("TX start %p: %s, tone %u Hz (%u frames)", (void *)stream, cfg->name, tone->freq_hz,
		slot->nframes);
	k_sem_give(&tx_sem);

	return 0;
}

void audio_tx_set_depth(struct bt_cap_stream *stream, uint8_t depth)
{
	struct tx_slot *slot;

	k_mutex_lock(&slots_lock, K_FOREVER);
	slot = find_slot(stream);
	if (slot != NULL) {
		slot->depth = depth;
	}
	k_mutex_unlock(&slots_lock);
	k_sem_give(&tx_sem);
}

void audio_tx_stop(struct bt_cap_stream *stream)
{
	struct tx_slot *slot;

	k_mutex_lock(&slots_lock, K_FOREVER);
	slot = find_slot(stream);
	if (slot != NULL) {
		K_SPINLOCK(&bind_lock) {
			slot->stream = NULL;
		}
	}
	k_mutex_unlock(&slots_lock);
}

void audio_tx_set_tone(struct bt_cap_stream *stream, const struct tone *tone)
{
	struct tx_slot *slot;

	k_mutex_lock(&slots_lock, K_FOREVER);
	slot = find_slot(stream);
	if (slot != NULL) {
		slot->tone = *tone;
		slot_load(slot);
	}
	k_mutex_unlock(&slots_lock);
}

void audio_tx_sent(struct bt_cap_stream *stream)
{
	/* Bluetooth TX path: only the spinlock, the TX thread may hold the mutex */
	K_SPINLOCK(&bind_lock) {
		for (size_t i = 0; i < ARRAY_SIZE(slots); i++) {
			if (slots[i].stream == stream) {
				if (slots[i].inflight > 0) {
					slots[i].inflight--;
				}
				slots[i].sent_count++;
				break;
			}
		}
	}

	k_sem_give(&tx_sem);
}

uint32_t audio_tx_sent_count(struct bt_cap_stream *stream)
{
	uint32_t count = 0;

	K_SPINLOCK(&bind_lock) {
		struct tx_slot *slot = find_slot(stream);

		count = slot != NULL ? slot->sent_count : 0;
	}

	return count;
}

const char *audio_ctx_str(enum bt_audio_context ctx)
{
	switch (ctx) {
	case BT_AUDIO_CONTEXT_TYPE_UNSPECIFIED:
		return "unspecified";
	case BT_AUDIO_CONTEXT_TYPE_CONVERSATIONAL:
		return "conversational";
	case BT_AUDIO_CONTEXT_TYPE_MEDIA:
		return "media";
	case BT_AUDIO_CONTEXT_TYPE_GAME:
		return "game";
	case BT_AUDIO_CONTEXT_TYPE_INSTRUCTIONAL:
		return "instructional";
	case BT_AUDIO_CONTEXT_TYPE_VOICE_ASSISTANTS:
		return "voice_assistants";
	case BT_AUDIO_CONTEXT_TYPE_LIVE:
		return "live";
	case BT_AUDIO_CONTEXT_TYPE_SOUND_EFFECTS:
		return "sound_effects";
	case BT_AUDIO_CONTEXT_TYPE_NOTIFICATIONS:
		return "notifications";
	case BT_AUDIO_CONTEXT_TYPE_RINGTONE:
		return "ringtone";
	case BT_AUDIO_CONTEXT_TYPE_ALERTS:
		return "alerts";
	case BT_AUDIO_CONTEXT_TYPE_EMERGENCY_ALARM:
		return "emergency_alarm";
	default:
		return "mixed";
	}
}
```

## src/audio_tx.h
```c
/*
 * Copyright (c) 2026 Hubert Włodarczyk
 *
 * SPDX-License-Identifier: MPL-2.0
 */

/*
 * Tones on ISO streams (unicast sink ASEs and broadcast BISes) from the precomputed LC3 frame
 * table (lc3_frames.c): no encoder, no DSP.
 */

#ifndef LEABENCH_AUDIO_TX_H_
#define LEABENCH_AUDIO_TX_H_

#include <stdbool.h>
#include <stdint.h>

#include <zephyr/bluetooth/audio/audio.h>
#include <zephyr/bluetooth/audio/cap.h>

enum tone_pattern {
	TONE_CONTINUOUS,
	TONE_RING, /* 1 s on, 1 s off */
	TONE_BEEP, /* 100 ms on, 100 ms off */
};

struct tone {
	uint32_t freq_hz; /* requested; the nearest tone of the table is sent, 0: silence */
	int8_t level_db;  /* dBFS, LC3_TAB_LEVEL_MIN..0 */
	enum tone_pattern pattern;
};

struct lc3_tab_cfg;

/* LC3 configuration of the frame table, NULL if there is none (CLI: audio_cfg_names()) */
const struct lc3_tab_cfg *audio_cfg_find(uint32_t sr_hz, uint32_t frame_us, uint16_t octets);
const char *audio_cfg_names(void);
/* Nearest tone of `cfg`: index > 0 (0 for silence) and its frequency in mHz. -ERANGE if out of
 * the table's range, -EINVAL if `exact` and the tone is not exactly freq_hz.
 */
int audio_tone_resolve(const struct lc3_tab_cfg *cfg, uint32_t freq_hz, bool exact,
		       uint32_t *actual_mhz);
void audio_tone_range(const struct lc3_tab_cfg *cfg, uint32_t *min_hz, uint32_t *max_hz,
		      uint32_t *step_mhz);
/* Level actually sent for level_db (global gain steps of 0.71 dB), in 1/100 dB */
int audio_level_actual_cdb(int8_t level_db);

int audio_tx_init(void);

/* Starts sending `tone` on a streaming CAP stream; -ENOTSUP if its codec configuration is not in
 * the frame table
 */
int audio_tx_start(struct bt_cap_stream *stream, const struct tone *tone);
/* SDUs kept queued in the controller for this stream (BIGs with BN > 1 need BN: the BN SDUs of
 * an event leave together); 0: the default policy
 */
void audio_tx_set_depth(struct bt_cap_stream *stream, uint8_t depth);
void audio_tx_stop(struct bt_cap_stream *stream);
void audio_tx_set_tone(struct bt_cap_stream *stream, const struct tone *tone);
/* To be called from the stream's `sent` callback */
void audio_tx_sent(struct bt_cap_stream *stream);
uint32_t audio_tx_sent_count(struct bt_cap_stream *stream);

/* Short name of an audio context ("media", "ringtone", ...) */
const char *audio_ctx_str(enum bt_audio_context ctx);

#endif /* LEABENCH_AUDIO_TX_H_ */
```

## src/bcast.h
```c
/*
 * Copyright (c) 2026 Hubert Włodarczyk
 *
 * SPDX-License-Identifier: MPL-2.0
 */

/*
 * Auracast broadcast sources built by the tester (bcast/, commands in bcast/cmds.c).
 */

#ifndef LEABENCH_BCAST_H_
#define LEABENCH_BCAST_H_

int bcast_init(void);

/* Stops and deletes all broadcasts */
void bcast_reset(void);

/* Stops all broadcasts, keeping their configuration */
void bcast_stop_all(void);

/* Streaming BIGs and all configured ones (streaming included) */
void bcast_counts(int *active, int *configured);

/* "none", "draft" or "streaming" (of the most advanced broadcast) */
const char *bcast_state_str(void);

#endif /* LEABENCH_BCAST_H_ */
```

## src/call.c
```c
/*
 * Copyright (c) 2026 Hubert Włodarczyk
 *
 * SPDX-License-Identifier: MPL-2.0
 */

/*
 * Call signalling as a Telephone Bearer Service server (Generic TBS, Call Control Profile).
 * Local actions are plain wrappers; what the device does (CCP client) is forwarded to the
 * phone state machine.
 */

#include <errno.h>

#include <zephyr/bluetooth/audio/tbs.h>
#include <zephyr/bluetooth/conn.h>
#include <zephyr/logging/log.h>

#include "cli.h"
#include "phone.h"

LOG_MODULE_REGISTER(call, LOG_LEVEL_INF);

#define LOCAL_URI "tel:000000"

int call_incoming(const char *uri, const char *name)
{
	return bt_tbs_remote_incoming(BT_TBS_GTBS_INDEX, LOCAL_URI, uri,
				      name != NULL && name[0] != '\0' ? name : NULL);
}

int call_originate(const char *uri)
{
	uint8_t idx;
	int err = bt_tbs_originate(BT_TBS_GTBS_INDEX, (char *)uri, &idx);

	return err != 0 ? err : idx;
}

int call_accept(uint8_t idx)
{
	return bt_tbs_accept(idx);
}

int call_remote_answer(uint8_t idx)
{
	return bt_tbs_remote_answer(idx);
}

int call_terminate(uint8_t idx)
{
	return bt_tbs_terminate(idx);
}

int call_hold(uint8_t idx)
{
	return bt_tbs_hold(idx);
}

int call_retrieve(uint8_t idx)
{
	return bt_tbs_retrieve(idx);
}

/* --- Requests from the device --- */

static bool tbs_originate(struct bt_conn *conn, uint8_t call_index, const char *uri)
{
	ARG_UNUSED(conn);

	cli_evt("source_call_request", "idx=%u op=originate uri=%s", call_index, CLI_Q(uri));
	if (!phone_takes_peer_call()) {
		/* Refused in GTBS, not created and left alerting */
		return false;
	}

	phone_post_event(PH_EV_PEER_ORIGINATED, call_index);

	return true;
}

static void tbs_terminate(struct bt_conn *conn, uint8_t call_index, uint8_t reason)
{
	ARG_UNUSED(conn);
	ARG_UNUSED(reason);

	phone_post_event(PH_EV_PEER_TERMINATED, call_index);
}

static void tbs_accept(struct bt_conn *conn, uint8_t call_index)
{
	ARG_UNUSED(conn);

	phone_post_event(PH_EV_PEER_ACCEPTED, call_index);
}

static void tbs_hold(struct bt_conn *conn, uint8_t call_index)
{
	ARG_UNUSED(conn);

	phone_post_event(PH_EV_PEER_HELD, call_index);
}

static void tbs_retrieve(struct bt_conn *conn, uint8_t call_index)
{
	ARG_UNUSED(conn);

	phone_post_event(PH_EV_PEER_RETRIEVED, call_index);
}

static bool tbs_authorize(struct bt_conn *conn)
{
	ARG_UNUSED(conn);

	return true;
}

static struct bt_tbs_cb tbs_cbs = {
	.originate_call = tbs_originate,
	.terminate_call = tbs_terminate,
	.accept_call = tbs_accept,
	.hold_call = tbs_hold,
	.retrieve_call = tbs_retrieve,
	.authorize = tbs_authorize,
};

int call_init(void)
{
	const struct bt_tbs_register_param gtbs_param = {
		.provider_name = "LEA Bench Phone",
		.uci = "un000",
		.uri_schemes_supported = "tel",
		.gtbs = true,
		.authorization_required = false,
		.technology = BT_BEARER_TECH_4G,
		.optional_opcodes = BT_TBS_OPTIONAL_OPCODE_HOLD | BT_TBS_OPTIONAL_OPCODE_JOIN,
	};
	int err;

	err = bt_tbs_register_bearer(&gtbs_param);
	if (err < 0) {
		LOG_ERR("GTBS register failed: %d", err);
		return err;
	}

	bt_tbs_register_cb(&tbs_cbs);

	return 0;
}
```

## src/cli_cmds.h
```c
/*
 * Copyright (c) 2026 Hubert Włodarczyk
 *
 * SPDX-License-Identifier: MPL-2.0
 */

/* Generated by tools/protogen/gen.py from protocol/leabench.yaml. Do not edit. */

#ifndef CLI_CMDS_H_
#define CLI_CMDS_H_

#include <stddef.h>

#include <zephyr/shell/shell.h>

int cmd_bonding_create(const struct shell *sh, size_t argc, char **argv);
int cmd_bonding_list(const struct shell *sh, size_t argc, char **argv);
int cmd_bonding_show(const struct shell *sh, size_t argc, char **argv);
int cmd_bonding_scan(const struct shell *sh, size_t argc, char **argv);
int cmd_bonding_connect(const struct shell *sh, size_t argc, char **argv);
int cmd_bonding_pair(const struct shell *sh, size_t argc, char **argv);
int cmd_bonding_passkey(const struct shell *sh, size_t argc, char **argv);
int cmd_bonding_confirm(const struct shell *sh, size_t argc, char **argv);
int cmd_bonding_unpair(const struct shell *sh, size_t argc, char **argv);
int cmd_bonding_disconnect(const struct shell *sh, size_t argc, char **argv);
int cmd_bonding_delete(const struct shell *sh, size_t argc, char **argv);
int cmd_bonding_bonds(const struct shell *sh, size_t argc, char **argv);
int cmd_bonding_io(const struct shell *sh, size_t argc, char **argv);
int cmd_bonding_param(const struct shell *sh, size_t argc, char **argv);
int cmd_bonding_phy(const struct shell *sh, size_t argc, char **argv);
int cmd_bonding_dle(const struct shell *sh, size_t argc, char **argv);
int cmd_bonding_txpower(const struct shell *sh, size_t argc, char **argv);
int cmd_bonding_policy(const struct shell *sh, size_t argc, char **argv);
int cmd_le_source_attach(const struct shell *sh, size_t argc, char **argv);
int cmd_le_source_detach(const struct shell *sh, size_t argc, char **argv);
int cmd_le_source_music_start(const struct shell *sh, size_t argc, char **argv);
int cmd_le_source_music_stop(const struct shell *sh, size_t argc, char **argv);
int cmd_le_source_call_incoming(const struct shell *sh, size_t argc, char **argv);
int cmd_le_source_call_outgoing(const struct shell *sh, size_t argc, char **argv);
int cmd_le_source_call_accept(const struct shell *sh, size_t argc, char **argv);
int cmd_le_source_call_remote_answer(const struct shell *sh, size_t argc, char **argv);
int cmd_le_source_call_end(const struct shell *sh, size_t argc, char **argv);
int cmd_le_source_call_hold(const struct shell *sh, size_t argc, char **argv);
int cmd_le_source_call_retrieve(const struct shell *sh, size_t argc, char **argv);
int cmd_le_source_alert(const struct shell *sh, size_t argc, char **argv);
int cmd_le_source_volume_set(const struct shell *sh, size_t argc, char **argv);
int cmd_le_source_volume_up(const struct shell *sh, size_t argc, char **argv);
int cmd_le_source_volume_down(const struct shell *sh, size_t argc, char **argv);
int cmd_le_source_mute(const struct shell *sh, size_t argc, char **argv);
int cmd_le_source_preset_list(const struct shell *sh, size_t argc, char **argv);
int cmd_le_source_preset_next(const struct shell *sh, size_t argc, char **argv);
int cmd_le_source_preset_prev(const struct shell *sh, size_t argc, char **argv);
int cmd_le_source_preset_set(const struct shell *sh, size_t argc, char **argv);
int cmd_le_source_mic_mute(const struct shell *sh, size_t argc, char **argv);
int cmd_le_source_mic_gain(const struct shell *sh, size_t argc, char **argv);
int cmd_le_source_balance_set(const struct shell *sh, size_t argc, char **argv);
int cmd_le_source_stop(const struct shell *sh, size_t argc, char **argv);
int cmd_le_source_status(const struct shell *sh, size_t argc, char **argv);
int cmd_mode(const struct shell *sh, size_t argc, char **argv);
int cmd_help(const struct shell *sh, size_t argc, char **argv);
int cmd_radio_schedule(const struct shell *sh, size_t argc, char **argv);
int cmd_version(const struct shell *sh, size_t argc, char **argv);
int cmd_status(const struct shell *sh, size_t argc, char **argv);
int cmd_reset(const struct shell *sh, size_t argc, char **argv);
int cmd_stop(const struct shell *sh, size_t argc, char **argv);
int cmd_proto(const struct shell *sh, size_t argc, char **argv);
int cmd_limits(const struct shell *sh, size_t argc, char **argv);
int cmd_id(const struct shell *sh, size_t argc, char **argv);
int cmd_time(const struct shell *sh, size_t argc, char **argv);
int cmd_evt_off(const struct shell *sh, size_t argc, char **argv);
int cmd_evt_on(const struct shell *sh, size_t argc, char **argv);
int cmd_evt_list(const struct shell *sh, size_t argc, char **argv);
int cmd_cli_spec(const struct shell *sh, size_t argc, char **argv);
int cmd_cli_stats(const struct shell *sh, size_t argc, char **argv);
int cmd_cli_burst(const struct shell *sh, size_t argc, char **argv);
int cmd_broadcast_list(const struct shell *sh, size_t argc, char **argv);
int cmd_broadcast_budget(const struct shell *sh, size_t argc, char **argv);
int cmd_broadcast_start_all(const struct shell *sh, size_t argc, char **argv);
int cmd_broadcast_stop_all(const struct shell *sh, size_t argc, char **argv);
int cmd_broadcast_restart_all(const struct shell *sh, size_t argc, char **argv);
int cmd_broadcast_create(const struct shell *sh, size_t argc, char **argv);
int cmd_broadcast_set(const struct shell *sh, size_t argc, char **argv);
int cmd_broadcast_delete(const struct shell *sh, size_t argc, char **argv);
int cmd_broadcast_show(const struct shell *sh, size_t argc, char **argv);
int cmd_broadcast_start(const struct shell *sh, size_t argc, char **argv);
int cmd_broadcast_stop(const struct shell *sh, size_t argc, char **argv);
int cmd_broadcast_restart(const struct shell *sh, size_t argc, char **argv);
int cmd_broadcast_txpower(const struct shell *sh, size_t argc, char **argv);
int cmd_broadcast_subgroup_add(const struct shell *sh, size_t argc, char **argv);
int cmd_broadcast_subgroup_set(const struct shell *sh, size_t argc, char **argv);
int cmd_broadcast_subgroup_delete(const struct shell *sh, size_t argc, char **argv);
int cmd_broadcast_subgroup_list(const struct shell *sh, size_t argc, char **argv);
int cmd_broadcast_bis_add(const struct shell *sh, size_t argc, char **argv);
int cmd_broadcast_bis_set(const struct shell *sh, size_t argc, char **argv);
int cmd_broadcast_bis_tone(const struct shell *sh, size_t argc, char **argv);
int cmd_broadcast_bis_delete(const struct shell *sh, size_t argc, char **argv);
int cmd_broadcast_bis_list(const struct shell *sh, size_t argc, char **argv);

#endif /* CLI_CMDS_H_ */
```

## src/dev.h
```c
/*
 * Copyright (c) 2026 Hubert Włodarczyk
 *
 * SPDX-License-Identifier: MPL-2.0
 */

/*
 * Virtual devices: separate local identities (address, IRK, keys) that connect to and bond
 * with the device independently (dev.c, commands in dev_cmds.c).
 */

#ifndef LEABENCH_DEV_H_
#define LEABENCH_DEV_H_

#include <stdbool.h>
#include <stdint.h>

#include <zephyr/bluetooth/conn.h>

#include "cli.h"

int dev_init(void);

/* Disconnects and deletes all virtual devices */
void dev_reset(void);

/* Disconnects all virtual devices, keeping their identities and bonds */
void dev_disconnect_all(void);

/* Connection of a virtual device, or NULL. No reference is taken. */
struct bt_conn *dev_get_conn(uint8_t id);

/* Identity attached to the LE Audio source ('le-source attach', 0: none) */
uint8_t dev_selected(void);

/* Layers of an identity's state, as 'bonding list', 'status' and 'le-source status' show them */
struct dev_state {
	const char *name;       /* "none" if there is no such identity */
	const char *connection; /* disconnected | connecting | connected */
	const char *security;   /* unencrypted | encrypted */
	const char *bond;       /* absent | present */
	int bonds;
	char peer[CLI_ADDR_STR_LEN]; /* connected device, or "none" */
	const char *peer_name;       /* its Bluetooth name if known (connect by name), or "none" */
	bool attached;
};

void dev_state_get(uint8_t id, struct dev_state *st);
uint8_t dev_count(void);
uint8_t dev_conn_count(void);

#endif /* LEABENCH_DEV_H_ */
```

## src/dev_cmds.c
```c
/*
 * Copyright (c) 2026 Hubert Włodarczyk
 *
 * SPDX-License-Identifier: MPL-2.0
 */

/* 'bonding' commands of the identities: create, list, show, unpair, delete, bonds, io. */

#include <ctype.h>
#include <errno.h>
#include <stdio.h>
#include <stdlib.h>
#include <string.h>

#include <zephyr/bluetooth/bluetooth.h>
#include <zephyr/bluetooth/conn.h>
#include <zephyr/kernel.h>
#include <zephyr/shell/shell.h>

#include "dev.h"
#include "dev_internal.h"
#include "mode.h"
#include "cli.h"
#include "cli_cmds.h"
#include "cli_tree.h"
#include "hci_util.h"

int parse_io(const char *str)
{
	for (int i = 0; i < IO_COUNT; i++) {
		if (strcmp(io_names[i], str) == 0) {
			return i;
		}
	}

	return -EINVAL;
}

static bool all_digits(const char *s)
{
	if (*s == '\0') {
		return false;
	}

	for (; *s != '\0'; s++) {
		if (!isdigit((unsigned char)*s)) {
			return false;
		}
	}

	return true;
}

int parse_ref(const struct shell *sh, const char *arg, uint8_t *id)
{
	int found;

	*id = 0;
	if (all_digits(arg)) {
		if (cli_parse_u8(arg, id) == 0 && vdev_valid(*id)) {
			return 0;
		}
	} else {
		found = vdev_find(arg);
		if (found > 0) {
			*id = found;
			return 0;
		}
	}

	cli_err_hint(sh, -ENOENT, "bonding list", "no identity %s", CLI_QS(arg));

	return -ENOENT;
}

/* bonding create [<name>] [io=] [addr=] */
int cmd_bonding_create(const struct shell *sh, size_t argc, char **argv)
{
	const char *name = argc > 1 && strchr(argv[1], '=') == NULL ? argv[1] : NULL;
	const char *addr_arg = cli_kv(argc, argv, "addr");
	const char *io_arg = cli_kv(argc, argv, "io");
	int io = IO_NONE;
	bt_addr_le_t addr;
	char addr_str[CLI_ADDR_STR_LEN];
	char auto_name[NAME_LEN];
	int id = -ENOMEM;

	if (io_arg != NULL) {
		io = parse_io(io_arg);
		if (io < 0) {
			return cli_err(sh, -EINVAL, "io: none display yesno keyboard kbd_display");
		}
	}

	if (addr_arg != NULL) {
		if (cli_parse_addr(addr_arg, &addr) != 0 || addr.type != BT_ADDR_LE_RANDOM ||
		    !BT_ADDR_IS_STATIC(&addr.a)) {
			return cli_err(sh, -EINVAL, "addr must be a static random address");
		}
	}

	/* A name is the tester's handle: unique, and never a number (that would be an id) */
	if (name != NULL) {
		if (strlen(name) >= NAME_LEN || all_digits(name)) {
			return cli_err(sh, -EINVAL, "name: 1..%d characters, not only digits",
				       NAME_LEN - 1);
		}

		if (vdev_find(name) > 0) {
			return cli_err_hint(sh, -EEXIST, "bonding delete <name>",
					    "identity %s exists", CLI_QS(name));
		}
	}

	if (mode_require(sh, MODE_UNICAST) != 0) {
		return -EBUSY;
	}

	/* Reclaim a deleted identity first, so the identity table does not fill up */
	for (uint8_t i = 1; i < ARRAY_SIZE(vdevs); i++) {
		if (vdevs[i].state == SLOT_DELETED) {
			id = bt_id_reset(i, addr_arg != NULL ? &addr : NULL, NULL);
			break;
		}
	}

	if (id < 0) {
		id = bt_id_create(addr_arg != NULL ? &addr : NULL, NULL);
	}

	if (id < 0) {
		return cli_err(sh, id, "cannot create identity");
	}

	vdevs[id].state = SLOT_USED;
	vdevs[id].conn = NULL;
	vdevs[id].connected = false;
	vdevs[id].peer_name[0] = '\0';
	if (name != NULL) {
		snprintf(vdevs[id].name, sizeof(vdevs[id].name), "%s", name);
	} else {
		/* identity<id>, or identity<id>-2, -3 ... if the tester already took that name */
		vdevs[id].name[0] = '\0';
		snprintf(auto_name, sizeof(auto_name), "identity%u", (uint8_t)id);
		for (unsigned int k = 2; vdev_find(auto_name) > 0; k++) {
			snprintf(auto_name, sizeof(auto_name), "identity%u-%u", (uint8_t)id, k);
		}
		snprintf(vdevs[id].name, sizeof(vdevs[id].name), "%s", auto_name);
	}

	vdevs[id].io = io;

	vdev_addr_str(id, addr_str, sizeof(addr_str));
	cli_ok(sh, "id=%d name=%s addr=%s io=%s", id, CLI_Q(vdevs[id].name), addr_str,
	       io_names[io]);

	return 0;
}

int cmd_bonding_list(const struct shell *sh, size_t argc, char **argv)
{
	const bool human = cli_proto_get() == CLI_PROTO_HUMAN;
	uint8_t n = 0;

	ARG_UNUSED(argc);
	ARG_UNUSED(argv);

	if (human) {
		if (dev_count() == 0) {
			shell_print(sh, "No identities yet. Create one: bonding create <name>");
		} else {
			shell_print(sh, "%-3s %-16s %-13s %-30s %-12s %-8s %s", "ID", "NAME",
				    "CONNECTION", "DEVICE", "SECURITY", "BOND", "SOURCE");
		}
	}

	for (uint8_t id = 1; id < ARRAY_SIZE(vdevs); id++) {
		struct dev_state st;
		char addr[CLI_ADDR_STR_LEN];

		if (vdevs[id].state != SLOT_USED) {
			continue;
		}

		dev_state_get(id, &st);
		vdev_addr_str(id, addr, sizeof(addr));
		if (human) {
			shell_print(sh, "%-3u %-16s %-13s %-30s %-12s %-8s %s", id, st.name,
				    st.connection,
				    strcmp(st.peer_name, "none") != 0 ? st.peer_name : st.peer,
				    st.security, st.bond, st.attached ? "attached" : "no");
		} else {
			cli_line(sh,
				 "IDENTITY id=%u name=%s addr=%s io=%s connection=%s device=%s "
				 "device_name=%s security=%s bond=%s bonds=%d source=%d",
				 id, CLI_Q(st.name), addr, io_names[vdevs[id].io], st.connection,
				 st.peer, CLI_Q(st.peer_name), st.security, st.bond, st.bonds,
				 st.attached);
		}

		n++;
	}

	cli_ok(sh, "count=%u", n);

	return 0;
}

/* bonding show <identity> [--verbose]: one identity; with --verbose the link parameters */
int cmd_bonding_show(const struct shell *sh, size_t argc, char **argv)
{
	struct bt_conn_info info = {0};
	char addr[CLI_ADDR_STR_LEN];
	struct dev_state st;
	char link[160] = "";
	uint8_t id;

	if (parse_ref(sh, argv[1], &id) != 0) {
		return -ENOENT;
	}

	dev_state_get(id, &st);
	vdev_addr_str(id, addr, sizeof(addr));
	if (cli_flag(argc, argv, "verbose")) {
		const bool up = vdevs[id].connected && bt_conn_get_info(vdevs[id].conn, &info) == 0;

		snprintf(link, sizeof(link), " rssi=%d interval_us=%u latency=%u sto_ms=%u phy=%s",
			 up ? hci_read_rssi(vdevs[id].conn) : 127, up ? info.le.interval_us : 0,
			 up ? info.le.latency : 0, up ? info.le.timeout * 10U : 0,
			 up && info.le.phy != NULL ? vdev_phy_str(info.le.phy->tx_phy) : "none");
	}

	cli_ok(sh,
	       "id=%u name=%s addr=%s io=%s connection=%s device=%s device_name=%s security=%s "
	       "bond=%s bonds=%d source=%d%s",
	       id, CLI_Q(st.name), addr, io_names[vdevs[id].io], st.connection, st.peer,
	       CLI_Q(st.peer_name), st.security, st.bond, st.bonds, st.attached, link);

	return 0;
}

int cmd_bonding_unpair(const struct shell *sh, size_t argc, char **argv)
{
	uint8_t id;
	int err;

	ARG_UNUSED(argc);

	if (parse_ref(sh, argv[1], &id) != 0) {
		return -ENOENT;
	}

	if (mode_require(sh, MODE_UNICAST) != 0) {
		return -EBUSY;
	}

	/* Forget the keys locally only: the peer still has them ("phone forgot the device") */
	err = bt_unpair(id, NULL);
	if (err != 0) {
		return cli_err(sh, err, "unpair failed");
	}

	cli_ok(sh, "id=%u bond=absent", id);

	return 0;
}

int cmd_bonding_delete(const struct shell *sh, size_t argc, char **argv)
{
	uint8_t id;
	int err;

	ARG_UNUSED(argc);

	if (parse_ref(sh, argv[1], &id) != 0) {
		return -ENOENT;
	}

	if (mode_require(sh, MODE_UNICAST) != 0) {
		return -EBUSY;
	}

	err = vdev_destroy(id);
	if (err != 0) {
		return cli_err(sh, err, "delete failed");
	}

	cli_ok(sh, "id=%u", id);

	return 0;
}

static void print_bond(const struct bt_bond_info *info, void *user_data)
{
	const struct shell *sh = user_data;
	char peer[CLI_ADDR_STR_LEN];

	cli_addr_str(&info->addr, peer, sizeof(peer));
	cli_line(sh, "BOND peer=%s", peer);
}

int cmd_bonding_bonds(const struct shell *sh, size_t argc, char **argv)
{
	uint8_t id;

	ARG_UNUSED(argc);

	if (parse_ref(sh, argv[1], &id) != 0) {
		return -ENOENT;
	}

	bt_foreach_bond(id, print_bond, (void *)sh);
	cli_ok(sh, "id=%u count=%d", id, vdev_bond_count(id));

	return 0;
}

int cmd_bonding_io(const struct shell *sh, size_t argc, char **argv)
{
	uint8_t id;
	int io;

	ARG_UNUSED(argc);

	if (parse_ref(sh, argv[1], &id) != 0) {
		return -ENOENT;
	}

	io = parse_io(argv[2]);
	if (io < 0) {
		return cli_err(sh, -EINVAL, "io: none display yesno keyboard kbd_display");
	}

	if (mode_require(sh, MODE_UNICAST) != 0) {
		return -EBUSY;
	}

	/* Takes effect on the next connection (callbacks are bound when it is established) */
	vdevs[id].io = io;
	cli_ok(sh, "id=%u io=%s", id, io_names[io]);

	return 0;
}
```
