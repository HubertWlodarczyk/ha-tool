## CMakeLists.txt
```
# Copyright (c) 2026 Hubert Włodarczyk
# SPDX-License-Identifier: MPL-2.0

cmake_minimum_required(VERSION 3.20.0)

find_package(Zephyr REQUIRED HINTS $ENV{ZEPHYR_BASE})
project(dut_sim)

target_sources(app PRIVATE
  src/main.c
  src/pairing.c
  src/audio_rx.c
  src/unicast.c
  src/ctrl.c
  src/audio_services.c
  src/bsink.c
  ../common/src/cli_out.c
  ../common/src/cli_evt.c
  ../common/src/cli_parse.c
  ../common/src/hci_util.c
)

target_include_directories(app PRIVATE
  src
  ../common/include
)
```

## prj.conf
```kconfig
# Simulated device (device under test) for leabench development.

# --- CLI (same conventions as leabench) ---
CONFIG_SERIAL=y
CONFIG_UART_INTERRUPT_DRIVEN=y
CONFIG_SHELL=y
CONFIG_SHELL_BACKEND_SERIAL=y
CONFIG_SHELL_PROMPT_UART=""
CONFIG_SHELL_ECHO_STATUS=n
CONFIG_SHELL_VT100_COLORS=n
CONFIG_SHELL_VT100_COMMANDS=n
CONFIG_SHELL_LOG_BACKEND=n
CONFIG_SHELL_STACK_SIZE=4096
CONFIG_SHELL_CMD_BUFF_SIZE=256
CONFIG_SHELL_ARGC_MAX=16
CONFIG_SHELL_BACKEND_SERIAL_TX_RING_BUFFER_SIZE=2048

CONFIG_LOG=y
CONFIG_MAIN_STACK_SIZE=4096
CONFIG_SYSTEM_WORKQUEUE_STACK_SIZE=2048
CONFIG_BT_RX_STACK_SIZE=4096
CONFIG_FPU=y
CONFIG_LIBLC3=y
CONFIG_UTF8=y

# --- Bluetooth ---
CONFIG_BT=y
CONFIG_BT_DEVICE_NAME="DUT-LEA"
CONFIG_BT_PERIPHERAL=y
CONFIG_BT_OBSERVER=y
CONFIG_BT_SMP=y
CONFIG_BT_GATT_CLIENT=y
CONFIG_BT_GATT_DYNAMIC_DB=y
CONFIG_BT_GATT_AUTO_DISCOVER_CCC=y
CONFIG_BT_GATT_AUTO_UPDATE_MTU=y
CONFIG_BT_EXT_ADV=y
CONFIG_BT_PER_ADV_SYNC=y
CONFIG_BT_MAX_CONN=3
CONFIG_BT_GAP_AUTO_UPDATE_CONN_PARAMS=n
CONFIG_BT_ATT_PREPARE_COUNT=1

# Small bond list, like a device. When full, the oldest bond is replaced
# (build with -DCONFIG_BT_KEYS_OVERWRITE_OLDEST=n to reject new bonds instead).
CONFIG_BT_MAX_PAIRED=4
CONFIG_BT_KEYS_OVERWRITE_OLDEST=y

# --- LE Audio acceptor ---
CONFIG_BT_AUDIO=y
CONFIG_BT_CAP_ACCEPTOR=y
CONFIG_BT_BAP_UNICAST_SERVER=y
CONFIG_BT_ISO_PERIPHERAL=y
CONFIG_BT_ISO_SYNC_RECEIVER=y
CONFIG_BT_ISO_MAX_CHAN=10
CONFIG_BT_ISO_RX_MTU=155
CONFIG_BT_ISO_TX_MTU=155
CONFIG_BT_ASCS=y
CONFIG_BT_ASCS_MAX_ASE_SNK_COUNT=2
CONFIG_BT_ASCS_MAX_ASE_SRC_COUNT=1
CONFIG_BT_PAC_SNK=y
CONFIG_BT_PAC_SNK_LOC=y
CONFIG_BT_PAC_SRC=y
CONFIG_BT_PAC_SRC_LOC=y
CONFIG_BT_AUDIO_CODEC_CFG_MAX_METADATA_SIZE=32
CONFIG_BT_BAP_SCAN_DELEGATOR=y
CONFIG_BT_BAP_BROADCAST_SINK=y
CONFIG_BT_BAP_BROADCAST_SNK_STREAM_COUNT=8
CONFIG_BT_PBP=y

# Device controls: call control client, media control client, volume renderer
CONFIG_BT_TBS_CLIENT_GTBS=y
CONFIG_BT_CCP_CALL_CONTROL_CLIENT=y
CONFIG_BT_MCC=y
CONFIG_BT_VCP_VOL_REND=y
CONFIG_BT_ATT_TX_COUNT=16
CONFIG_BT_L2CAP_TX_BUF_COUNT=16
CONFIG_BT_BAP_BASS_MAX_SUBGROUPS=4
CONFIG_BT_BAP_BROADCAST_SNK_SUBGROUP_COUNT=4

# Bonds survive a restart (persistence tests)
CONFIG_FLASH=y
CONFIG_FLASH_MAP=y
CONFIG_NVS=y
CONFIG_SETTINGS=y
CONFIG_SETTINGS_NVS=y
CONFIG_BT_SETTINGS=y

CONFIG_BT_USER_PHY_UPDATE=y

# Device services controlled by leabench: presets, microphone, balance
CONFIG_BT_HAS=y
CONFIG_BT_HAS_PRESET_COUNT=3
CONFIG_BT_MICP_MIC_DEV=y
CONFIG_BT_AICS_MAX_INSTANCE_COUNT=1
CONFIG_BT_MICP_MIC_DEV_AICS_INSTANCE_COUNT=1
CONFIG_BT_VOCS_MAX_INSTANCE_COUNT=1
CONFIG_BT_VCP_VOL_REND_VOCS_INSTANCE_COUNT=1
```

## netcore_rx.conf
```kconfig
# dut_sim only (simulation, RAM not limited): receive up to 8 BISes of one BIG, so the tests can
# verify leabench's largest BIGs.
CONFIG_BT_CTLR_SYNC_ISO_STREAM_MAX=8
CONFIG_BT_CTLR_SYNC_ISO_STREAM_COUNT=8
CONFIG_BT_CTLR_ISOAL_SINKS=10
CONFIG_BT_CTLR_ISO_RX_BUFFERS=16
```

## boards/nrf5340bsim_nrf5340_cpuapp.conf
```kconfig
# Logs go to the simulator's stdout, the CLI owns UART0
CONFIG_UART_CONSOLE=n
CONFIG_LOG_BACKEND_UART=n
CONFIG_BT_BUF_EVT_RX_SIZE=255
CONFIG_BT_BUF_ACL_RX_SIZE=255
CONFIG_BT_BUF_ACL_TX_SIZE=251
CONFIG_BT_BUF_CMD_TX_SIZE=255
# Simulation: no lost logs on crash, catch asserts
CONFIG_LOG_MODE_IMMEDIATE=y
CONFIG_ASSERT=y
```

## boards/nrf5340dk_nrf5340_cpuapp.conf
```kconfig
# CLI on the VCOM UART, logs on RTT
CONFIG_UART_CONSOLE=n
CONFIG_LOG_BACKEND_UART=n
CONFIG_USE_SEGGER_RTT=y
CONFIG_LOG_BACKEND_RTT=y
CONFIG_BT_BUF_EVT_RX_SIZE=255
CONFIG_BT_BUF_ACL_RX_SIZE=255
CONFIG_BT_BUF_ACL_TX_SIZE=251
CONFIG_BT_BUF_CMD_TX_SIZE=255
```

## boards/nrf5340bsim_nrf5340_cpuapp.overlay
```dts
/ {
	chosen {
		/* CLI on UART0, exposed as a pseudoterminal with -uart0_pty */
		zephyr,shell-uart = &uart0;
	};
};
```

## src/main.c
```c
/*
 * Copyright (c) 2026 Hubert Włodarczyk
 *
 * SPDX-License-Identifier: MPL-2.0
 */

/*
 * dut_sim: a simulated LE Audio device used as the device under test while developing
 * leabench without hardware. CAP acceptor (unicast sink + source, broadcast sink), call control
 * client, media control client and volume renderer, with a small bond list.
 */

#include <errno.h>
#include <stdlib.h>
#include <string.h>

#include <zephyr/bluetooth/audio/audio.h>
#include <zephyr/bluetooth/audio/bap.h>
#include <zephyr/bluetooth/audio/lc3.h>
#include <zephyr/bluetooth/audio/pacs.h>
#include <zephyr/bluetooth/bluetooth.h>
#include <zephyr/bluetooth/conn.h>
#include <zephyr/bluetooth/hci_types.h>
#include <zephyr/bluetooth/uuid.h>
#include <zephyr/kernel.h>
#include <zephyr/logging/log.h>
#include <zephyr/settings/settings.h>
#include <zephyr/shell/shell.h>
#include <zephyr/sys/byteorder.h>
#include <zephyr/version.h>

#include "cli.h"
#include "hci_util.h"
#include "dut.h"

LOG_MODULE_REGISTER(dut, LOG_LEVEL_INF);

static const struct bt_data ad[] = {
	BT_DATA_BYTES(BT_DATA_FLAGS, (BT_LE_AD_GENERAL | BT_LE_AD_NO_BREDR)),
	BT_DATA(BT_DATA_NAME_COMPLETE, CONFIG_BT_DEVICE_NAME, sizeof(CONFIG_BT_DEVICE_NAME) - 1),
	BT_DATA_BYTES(BT_DATA_UUID16_SOME, BT_UUID_16_ENCODE(BT_UUID_ASCS_VAL),
		      BT_UUID_16_ENCODE(BT_UUID_CAS_VAL), BT_UUID_16_ENCODE(BT_UUID_VCS_VAL)),
	BT_DATA_BYTES(BT_DATA_SVC_DATA16, BT_UUID_16_ENCODE(BT_UUID_CAS_VAL),
		      BT_AUDIO_UNICAST_ANNOUNCEMENT_GENERAL),
	BT_DATA_BYTES(BT_DATA_SVC_DATA16, BT_UUID_16_ENCODE(BT_UUID_ASCS_VAL),
		      BT_AUDIO_UNICAST_ANNOUNCEMENT_GENERAL, BT_BYTES_LIST_LE16(DUT_SINK_CONTEXTS),
		      BT_BYTES_LIST_LE16(DUT_SOURCE_CONTEXTS), 0x00),
};

static struct bt_le_ext_adv *adv;
static bool adv_enabled = true;
static bool adv_restart; /* the set was ended by a connection */
static bool adv_held;    /* paused while a periodic advertising sync is established */
static struct bt_conn *conns[CONFIG_BT_MAX_CONN];
/* conns[] changes in the Bluetooth RX thread (connected / disconnected) */
static struct k_spinlock conns_lock;

/* A reference to link i for a shell command, NULL if none; the caller unrefs it */
static struct bt_conn *conn_get(size_t i)
{
	struct bt_conn *conn = NULL;

	K_SPINLOCK(&conns_lock) {
		conn = conns[i] != NULL ? bt_conn_ref(conns[i]) : NULL;
	}

	return conn;
}

static void adv_work_handler(struct k_work *work);
static K_WORK_DEFINE(adv_work, adv_work_handler);

static uint8_t conn_count(void)
{
	uint8_t n = 0;

	for (size_t i = 0; i < ARRAY_SIZE(conns); i++) {
		n += conns[i] != NULL;
	}

	return n;
}

static void adv_work_handler(struct k_work *work)
{
	int err;

	ARG_UNUSED(work);

	if (!adv_enabled || adv_held || conn_count() >= CONFIG_BT_MAX_CONN) {
		(void)bt_le_ext_adv_stop(adv);
		return;
	}

	/* A connection ends the advertising set but the host may still see it as enabled:
	 * stop/start it then. Never stop a running set otherwise (stopping and restarting an
	 * active set right after a disconnection stalls the simulated controller).
	 */
	if (adv_restart) {
		adv_restart = false;
		(void)bt_le_ext_adv_stop(adv);
	}

	err = bt_le_ext_adv_start(adv, BT_LE_EXT_ADV_START_DEFAULT);
	if (err != 0 && err != -EALREADY) {
		LOG_WRN("Advertising start failed: %d", err);
	}
}

void dut_adv_hold(bool hold)
{
	if (hold != adv_held) {
		adv_held = hold;
		k_work_submit(&adv_work);
	}
}

/* --- Connection callbacks --- */

static void connected(struct bt_conn *conn, uint8_t err)
{
	char peer[CLI_ADDR_STR_LEN];

	if (err != 0) {
		return;
	}

	for (size_t i = 0; i < ARRAY_SIZE(conns); i++) {
		bool stored = false;

		K_SPINLOCK(&conns_lock) {
			if (conns[i] == NULL) {
				conns[i] = bt_conn_ref(conn);
				stored = true;
			}
		}

		if (stored) {
			break;
		}
	}

	cli_addr_str(bt_conn_get_dst(conn), peer, sizeof(peer));
	cli_evt("dut_connected", "peer=%s conns=%u bonded=%d", peer, conn_count(),
		bt_le_bond_exists(BT_ID_DEFAULT, bt_conn_get_dst(conn)));
	adv_restart = true;
	k_work_submit(&adv_work);
}

static void disconnected(struct bt_conn *conn, uint8_t reason)
{
	char peer[CLI_ADDR_STR_LEN];

	for (size_t i = 0; i < ARRAY_SIZE(conns); i++) {
		struct bt_conn *gone = NULL;

		K_SPINLOCK(&conns_lock) {
			if (conns[i] == conn) {
				gone = conns[i];
				conns[i] = NULL;
			}
		}

		if (gone != NULL) {
			bt_conn_unref(gone);
		}
	}

	ctrl_on_disconnected(conn);
	cli_addr_str(bt_conn_get_dst(conn), peer, sizeof(peer));
	cli_evt("dut_disconnected", "peer=%s reason=%s conns=%u", peer, cli_hci_reason_str(reason),
		conn_count());
}

static void recycled(void)
{
	k_work_submit(&adv_work);
}

static void security_changed(struct bt_conn *conn, bt_security_t level, enum bt_security_err err)
{
	char peer[CLI_ADDR_STR_LEN];

	cli_addr_str(bt_conn_get_dst(conn), peer, sizeof(peer));
	if (err != BT_SECURITY_ERR_SUCCESS) {
		cli_evt("dut_security_failed", "peer=%s err=%d", peer, err);
		return;
	}

	cli_evt("dut_security", "peer=%s level=%u", peer, level);
	if (level >= BT_SECURITY_L2) {
		ctrl_on_secure(conn);
	}
}

static void le_param_updated(struct bt_conn *conn, uint16_t interval, uint16_t latency,
			     uint16_t timeout)
{
	ARG_UNUSED(conn);

	cli_evt("dut_param_updated", "interval_us=%u latency=%u sto_ms=%u", interval * 1250U,
		latency, timeout * 10U);
}

static void le_phy_updated(struct bt_conn *conn, struct bt_conn_le_phy_info *param)
{
	static const char *const names[] = {"none", "1m", "2m", "none", "coded"};

	ARG_UNUSED(conn);

	cli_evt("dut_phy_updated", "tx=%s rx=%s", names[MIN(param->tx_phy, 4)],
		names[MIN(param->rx_phy, 4)]);
}

BT_CONN_CB_DEFINE(conn_cb) = {
	.connected = connected,
	.disconnected = disconnected,
	.recycled = recycled,
	.security_changed = security_changed,
	.le_param_updated = le_param_updated,
	.le_phy_updated = le_phy_updated,
};

/* --- Init --- */

static int register_pacs(void)
{
	static const struct bt_audio_codec_cap sink_cap = BT_AUDIO_CODEC_CAP_LC3(
		BT_AUDIO_CODEC_CAP_FREQ_ANY,
		BT_AUDIO_CODEC_CAP_DURATION_7_5 | BT_AUDIO_CODEC_CAP_DURATION_10,
		BT_AUDIO_CODEC_CAP_CHAN_COUNT_SUPPORT(1), 26, 155, 1, DUT_SINK_CONTEXTS);
	static const struct bt_audio_codec_cap source_cap = BT_AUDIO_CODEC_CAP_LC3(
		BT_AUDIO_CODEC_CAP_FREQ_16KHZ | BT_AUDIO_CODEC_CAP_FREQ_24KHZ |
			BT_AUDIO_CODEC_CAP_FREQ_32KHZ | BT_AUDIO_CODEC_CAP_FREQ_48KHZ,
		BT_AUDIO_CODEC_CAP_DURATION_7_5 | BT_AUDIO_CODEC_CAP_DURATION_10,
		BT_AUDIO_CODEC_CAP_CHAN_COUNT_SUPPORT(1), 26, 155, 1, DUT_SOURCE_CONTEXTS);
	static struct bt_pacs_cap sink = {.codec_cap = &sink_cap};
	static struct bt_pacs_cap source = {.codec_cap = &source_cap};
	const struct bt_pacs_register_param param = {
		.snk_pac = true,
		.snk_loc = true,
		.src_pac = true,
		.src_loc = true,
	};
	int err;

	err = bt_pacs_register(&param);
	err = err ?: bt_pacs_cap_register(BT_AUDIO_DIR_SINK, &sink);
	err = err ?: bt_pacs_cap_register(BT_AUDIO_DIR_SOURCE, &source);
	err = err ?: bt_pacs_set_location(BT_AUDIO_DIR_SINK, BT_AUDIO_LOCATION_FRONT_LEFT);
	err = err ?: bt_pacs_set_location(BT_AUDIO_DIR_SOURCE, BT_AUDIO_LOCATION_FRONT_LEFT);
	if (err != 0) {
		return err;
	}

	(void)bt_pacs_set_supported_contexts(BT_AUDIO_DIR_SINK, DUT_SINK_CONTEXTS);
	(void)bt_pacs_set_available_contexts(BT_AUDIO_DIR_SINK, DUT_SINK_CONTEXTS);
	(void)bt_pacs_set_supported_contexts(BT_AUDIO_DIR_SOURCE, DUT_SOURCE_CONTEXTS);
	(void)bt_pacs_set_available_contexts(BT_AUDIO_DIR_SOURCE, DUT_SOURCE_CONTEXTS);

	return 0;
}

int main(void)
{
	bt_addr_le_t addr;
	size_t count = 1;
	char addr_str[CLI_ADDR_STR_LEN];
	int err;

	err = bt_enable(NULL);
	err = err ?: settings_load();
	err = err ?: pairing_init();
	err = err ?: register_pacs();
	err = err ?: unicast_init();
	err = err ?: ctrl_init();
	err = err ?: audio_services_init();
	err = err ?: bsink_init();
	err = err ?: bt_le_ext_adv_create(BT_BAP_ADV_PARAM_CONN_QUICK, NULL, &adv);
	err = err ?: bt_le_ext_adv_set_data(adv, ad, ARRAY_SIZE(ad), NULL, 0);
	if (err != 0) {
		LOG_ERR("Init failed: %d", err);
		cli_evt("fatal", "err=%d", err);
		return 0;
	}

	k_work_submit(&adv_work);

	bt_id_get(&addr, &count);
	cli_addr_str(&addr, addr_str, sizeof(addr_str));
	cli_evt("ready", "app=dut_sim version=%s addr=%s max_bonds=%d bonds=%d", DUT_VERSION,
		addr_str, CONFIG_BT_MAX_PAIRED, dut_bond_count());

	return 0;
}

/* --- Shell commands --- */

static int cmd_version(const struct shell *sh, size_t argc, char **argv)
{
	ARG_UNUSED(argc);
	ARG_UNUSED(argv);

	cli_ok(sh, "app=dut_sim version=%s zephyr=%s", DUT_VERSION, KERNEL_VERSION_STRING);

	return 0;
}

static int cmd_addr(const struct shell *sh, size_t argc, char **argv)
{
	bt_addr_le_t addr;
	size_t count = 1;
	char addr_str[CLI_ADDR_STR_LEN];

	ARG_UNUSED(argc);
	ARG_UNUSED(argv);

	bt_id_get(&addr, &count);
	cli_addr_str(&addr, addr_str, sizeof(addr_str));
	cli_ok(sh, "addr=%s", addr_str);

	return 0;
}

static int cmd_status(const struct shell *sh, size_t argc, char **argv)
{
	ARG_UNUSED(argc);
	ARG_UNUSED(argv);

	cli_ok(sh, "conns=%u bonds=%d max_bonds=%d adv=%d streams=%u bcast=%s overwrite_oldest=%d",
	       conn_count(), dut_bond_count(), CONFIG_BT_MAX_PAIRED, adv_enabled,
	       unicast_stream_count(), bsink_state_str(),
	       IS_ENABLED(CONFIG_BT_KEYS_OVERWRITE_OLDEST));

	return 0;
}

/* RSSI of every link: what the device receives from the phone(s) */
static int cmd_rssi(const struct shell *sh, size_t argc, char **argv)
{
	char addr[CLI_ADDR_STR_LEN];
	int n = 0;

	ARG_UNUSED(argc);
	ARG_UNUSED(argv);

	for (size_t i = 0; i < ARRAY_SIZE(conns); i++) {
		struct bt_conn *conn = conn_get(i);

		if (conn != NULL) {
			cli_addr_str(bt_conn_get_dst(conn), addr, sizeof(addr));
			cli_line(sh, "LINK peer=%s rssi=%d", addr, hci_read_rssi(conn));
			bt_conn_unref(conn);
			n++;
		}
	}

	cli_ok(sh, "links=%d", n);

	return 0;
}

static int cmd_adv(const struct shell *sh, size_t argc, char **argv)
{
	ARG_UNUSED(argc);

	if (strcmp(argv[1], "on") != 0 && strcmp(argv[1], "off") != 0) {
		return cli_err(sh, -EINVAL, "use on|off");
	}

	adv_enabled = strcmp(argv[1], "on") == 0;
	k_work_submit(&adv_work);
	cli_ok(sh, "adv=%d", adv_enabled);

	return 0;
}

static int cmd_disconnect(const struct shell *sh, size_t argc, char **argv)
{
	ARG_UNUSED(argc);
	ARG_UNUSED(argv);

	for (size_t i = 0; i < ARRAY_SIZE(conns); i++) {
		struct bt_conn *conn = conn_get(i);

		if (conn != NULL) {
			(void)bt_conn_disconnect(conn, BT_HCI_ERR_REMOTE_USER_TERM_CONN);
			bt_conn_unref(conn);
		}
	}

	cli_ok(sh, NULL);

	return 0;
}

/* The device asks the central for other connection parameters (all links) */
static int cmd_conn_param(const struct shell *sh, size_t argc, char **argv)
{
	int err = 0;
	long interval = cli_kv_long(argc, argv, "interval", 50, &err);
	long latency = cli_kv_long(argc, argv, "latency", 0, &err);
	long sto = cli_kv_long(argc, argv, "sto", 4000, &err);
	struct bt_le_conn_param param;
	int sent = 0;

	/* Core spec ranges: interval 7.5 ms..4 s, latency 0..499, timeout 100 ms..32 s */
	if (err != 0 || (interval * 4) % 5 != 0 || sto % 10 != 0 || interval * 4 < 30 ||
	    interval > 4000 || latency < 0 || latency > 499 || sto < 100 || sto > 32000) {
		return cli_err(sh, -EINVAL,
			       "interval=<ms, 1.25 steps> latency=<n> sto=<ms, 10 steps>");
	}

	param.interval_min = param.interval_max = interval * 4 / 5;
	param.latency = latency;
	param.timeout = sto / 10;
	for (size_t i = 0; i < ARRAY_SIZE(conns); i++) {
		struct bt_conn *conn = conn_get(i);

		if (conn != NULL) {
			sent += bt_conn_le_param_update(conn, &param) == 0;
			bt_conn_unref(conn);
		}
	}

	cli_ok(sh, "requested=%d", sent);

	return 0;
}

SHELL_STATIC_SUBCMD_SET_CREATE(conn_cmds,
			       SHELL_CMD_ARG(param, NULL,
					     "[interval=<ms>] [latency=<n>] [sto=<ms>]",
					     cmd_conn_param, 1, 3),
			       SHELL_SUBCMD_SET_END);
SHELL_CMD_REGISTER(conn, &conn_cmds, "Link parameters", NULL);

SHELL_CMD_REGISTER(version, NULL, "Firmware version", cmd_version);
SHELL_CMD_REGISTER(addr, NULL, "Identity address", cmd_addr);
SHELL_CMD_REGISTER(status, NULL, "Overall state", cmd_status);
SHELL_CMD_REGISTER(rssi, NULL, "RSSI of every link", cmd_rssi);
SHELL_CMD_ARG_REGISTER(adv, NULL, "on|off", cmd_adv, 2, 0);
SHELL_CMD_REGISTER(disconnect, NULL, "Disconnect all links", cmd_disconnect);
```

## src/audio_rx.c
```c
/*
 * Copyright (c) 2026 Hubert Włodarczyk
 *
 * SPDX-License-Identifier: MPL-2.0
 */

/*
 * Receive-side audio check: LC3-decodes every frame and estimates the tone frequency from the
 * spacing of zero crossings (with hysteresis) inside each non-silent frame, so tone patterns
 * (ringtone, beeps) and their on/off edges do not bias the result. Reported once a second as:
 *   EVT dut_audio src=<label> freq=<Hz> level=<dBFS> active=<%> frames=<n> lost=<n> clip=<n>
 * clip counts decoded samples at full scale: a clipped tone (harmonics, heard as distortion).
 */

#include <errno.h>
#include <math.h>
#include <stdio.h>
#include <stdlib.h>
#include <string.h>

#include <zephyr/bluetooth/audio/audio.h>
#include <zephyr/logging/log.h>

#include "cli.h"
#include "dut.h"

LOG_MODULE_REGISTER(audio_rx, LOG_LEVEL_INF);

#define MAX_SAMPLES 480
#define HYSTERESIS  60
#define ACTIVE_PEAK 150 /* -47 dBFS: a frame with a lower peak counts as silence */
#define MAX_GAP     100 /* larger sequence number jumps are a stream restart, not loss */

int audio_rx_start(struct audio_rx *rx, const struct bt_audio_codec_cfg *cfg, const char *label)
{
	int freq = bt_audio_codec_cfg_get_freq(cfg);
	int dur = bt_audio_codec_cfg_get_frame_dur(cfg);
	int octets = bt_audio_codec_cfg_get_octets_per_frame(cfg);

	if (freq < 0 || dur < 0 || octets <= 0) {
		return -EINVAL;
	}

	memset(rx, 0, sizeof(*rx));
	snprintf(rx->label, sizeof(rx->label), "%s", label);
	rx->sr_hz = bt_audio_codec_cfg_freq_to_freq_hz(freq);
	rx->octets = octets;
	/* 44.1 kHz is coded like 48 kHz (same frame of 360 / 480 samples, lasting 8163 /
	 * 10884 us); tone frequency and time base use the real rate.
	 */
	rx->coded_hz = rx->sr_hz == 44100U ? 48000U : rx->sr_hz;
	rx->samples =
		lc3_frame_samples(bt_audio_codec_cfg_frame_dur_to_frame_dur_us(dur), rx->coded_hz);
	rx->decoder = lc3_setup_decoder(bt_audio_codec_cfg_frame_dur_to_frame_dur_us(dur),
					rx->coded_hz, 0, &rx->decoder_mem);
	if (rx->decoder == NULL || rx->samples <= 0) {
		return -EINVAL;
	}

	rx->frame_us = (uint32_t)((uint64_t)rx->samples * 1000000U / rx->sr_hz);

	rx->last_seq = -1;
	rx->active = true;
	LOG_INF("RX %s: %u Hz, %u us, %u octets", label, rx->sr_hz, rx->frame_us, rx->octets);

	return 0;
}

void audio_rx_stop(struct audio_rx *rx)
{
	rx->active = false;
}

static void report(struct audio_rx *rx)
{
	/* half periods / (2 * time they span) */
	const uint32_t freq =
		rx->span_samples > 0
			? (uint32_t)((uint64_t)rx->crossings * rx->sr_hz / 2U / rx->span_samples)
			: 0;
	/* Peak level in 1/10 dB */
	const int level = rx->peak > 0 ? (int)lroundf(200.0f * log10f(rx->peak / 32767.0f)) : -990;

	cli_evt("dut_audio", "src=%s freq=%u level=%s%d.%d active=%u frames=%u lost=%u clip=%u",
		rx->label, freq, level < 0 ? "-" : "", abs(level) / 10, abs(level) % 10,
		rx->active_frames * 100U / rx->frames, rx->frames, rx->lost, rx->clipped);

	rx->frames = 0;
	rx->active_frames = 0;
	rx->lost = 0;
	rx->clipped = 0;
	rx->crossings = 0;
	rx->span_samples = 0;
	rx->peak = 0;
}

/* Counts one frame (lost: concealed by the decoder) */
static void count_frame(struct audio_rx *rx, bool lost)
{
	rx->lost += lost;
	rx->frames++;
	rx->total_frames++;
}

/* Reports once a second of audio is complete */
static void report_if_due(struct audio_rx *rx)
{
	if (rx->frames * rx->frame_us >= USEC_PER_SEC) {
		report(rx);
	}
}

/* Frames the controller never delivered appear only as sequence number gaps: conceal them (PLC)
 * so the time base stays right, and count them as lost.
 */
static void conceal_gap(struct audio_rx *rx, uint16_t seq_num, int16_t *pcm)
{
	uint16_t gap;

	if (rx->last_seq < 0) {
		return;
	}

	gap = (uint16_t)(seq_num - (uint16_t)rx->last_seq - 1U);
	if (gap >= MAX_GAP) {
		return; /* restart of the stream rather than loss */
	}

	for (uint16_t i = 0; i < gap; i++) {
		(void)lc3_decode(rx->decoder, NULL, rx->octets, LC3_PCM_FORMAT_S16, pcm, 1);
		count_frame(rx, true);
		report_if_due(rx);
	}
}

/* Peak level and zero crossings (with hysteresis) of one decoded frame */
static void analyze(struct audio_rx *rx, const int16_t *pcm)
{
	int16_t frame_peak = 0;
	uint32_t frame_crossings = 0;
	int first = -1;
	int last = -1;

	for (int i = 0; i < rx->samples; i++) {
		const int16_t s = pcm[i];
		const int16_t mag = s < 0 ? (s == INT16_MIN ? INT16_MAX : -s) : s;

		frame_peak = MAX(frame_peak, mag);
		/* The decoder saturates to int16: a sample at the limit was clipped */
		rx->clipped += mag >= INT16_MAX - 1;
		if ((s > HYSTERESIS && rx->sign < 0) || (s < -HYSTERESIS && rx->sign > 0)) {
			frame_crossings++;
			first = first < 0 ? i : first;
			last = i;
		}

		if (s > HYSTERESIS) {
			rx->sign = 1;
		} else if (s < -HYSTERESIS) {
			rx->sign = -1;
		}
	}

	rx->peak = MAX(rx->peak, frame_peak);

	/* Only frames with a tone count, so ringtone / beep pauses do not bias the frequency */
	if (frame_peak >= ACTIVE_PEAK) {
		rx->active_frames++;
		if (frame_crossings >= 2) {
			rx->crossings += frame_crossings - 1;
			rx->span_samples += last - first;
		}
	}
}

void audio_rx_frame(struct audio_rx *rx, const struct bt_iso_recv_info *info,
		    const struct net_buf *buf)
{
	static int16_t pcm[MAX_SAMPLES];
	const bool valid = (info->flags & BT_ISO_FLAGS_VALID) != 0 && buf->len >= rx->octets;
	int err;

	if (!rx->active) {
		return;
	}

	conceal_gap(rx, info->seq_num, pcm);
	rx->last_seq = info->seq_num;

	/* An invalid frame is concealed by the decoder (NULL) */
	err = lc3_decode(rx->decoder, valid ? buf->data : NULL, rx->octets, LC3_PCM_FORMAT_S16, pcm,
			 1);
	if (err < 0) {
		LOG_WRN("decode failed: %d", err);
	}

	count_frame(rx, !valid);
	analyze(rx, pcm);
	report_if_due(rx);
}

const char *ctx_str(uint16_t ctx)
{
	switch (ctx) {
	case BT_AUDIO_CONTEXT_TYPE_UNSPECIFIED:
		return "unspecified";
	case BT_AUDIO_CONTEXT_TYPE_CONVERSATIONAL:
		return "conversational";
	case BT_AUDIO_CONTEXT_TYPE_MEDIA:
		return "media";
	case BT_AUDIO_CONTEXT_TYPE_RINGTONE:
		return "ringtone";
	case BT_AUDIO_CONTEXT_TYPE_ALERTS:
		return "alerts";
	case BT_AUDIO_CONTEXT_TYPE_NOTIFICATIONS:
		return "notifications";
	case BT_AUDIO_CONTEXT_TYPE_LIVE:
		return "live";
	case 0:
		return "none";
	default:
		return "other";
	}
}
```

## src/audio_services.c
```c
/*
 * Copyright (c) 2026 Hubert Włodarczyk
 *
 * SPDX-License-Identifier: MPL-2.0
 */

/*
 * Device services of the simulated device (servers): volume renderer with VOCS
 * (balance), presets (HAS) and microphone (MICP with AICS). Their changes are reported as events.
 */

#include <errno.h>
#include <stdlib.h>

#include <zephyr/bluetooth/audio/aics.h>
#include <zephyr/bluetooth/audio/has.h>
#include <zephyr/bluetooth/audio/micp.h>
#include <zephyr/bluetooth/audio/vocs.h>
#include <zephyr/bluetooth/audio/vcp.h>
#include <zephyr/bluetooth/conn.h>
#include <zephyr/kernel.h>
#include <zephyr/logging/log.h>
#include <zephyr/shell/shell.h>

#include "cli.h"
#include "dut.h"

/* --- Volume renderer --- */

static void vcp_state(struct bt_conn *conn, int err, uint8_t volume, uint8_t mute)
{
	ARG_UNUSED(conn);

	if (err == 0) {
		cli_evt("dut_volume", "volume=%u mute=%u", volume, mute);
	}
}

static struct bt_vcp_vol_rend_cb vcp_cbs = {
	.state = vcp_state,
};

static void vocs_state(struct bt_vocs *inst, int err, int16_t offset)
{
	ARG_UNUSED(inst);

	if (err == 0) {
		cli_evt("dut_balance", "offset=%d", offset);
	}
}

static struct bt_vocs_cb vocs_cbs = {
	.state = vocs_state,
};

/* --- Presets (HAS server) --- */

static const char *const preset_names[] = {"Universal", "Restaurant", "Music"};

static int preset_select(uint8_t index, bool sync)
{
	ARG_UNUSED(sync);

	if (index == 0 || index > ARRAY_SIZE(preset_names)) {
		return -ENOENT;
	}

	cli_evt("dut_preset", "active=%u name=%s", index, preset_names[index - 1]);

	return bt_has_preset_active_set(index);
}

static const struct bt_has_preset_ops preset_ops = {
	.select = preset_select,
};

/* --- Microphone (MICP + AICS servers) --- */

static void mic_mute(uint8_t mute)
{
	cli_evt("dut_mic", "mute=%u", mute);
}

static struct bt_micp_mic_dev_cb mic_cbs = {
	.mute = mic_mute,
};

static void mic_aics_state(struct bt_aics *inst, int err, int8_t gain, uint8_t mute, uint8_t mode)
{
	ARG_UNUSED(inst);

	if (err == 0) {
		cli_evt("dut_mic_input", "gain=%d mute=%u mode=%u", gain, mute, mode);
	}
}

static struct bt_aics_cb mic_aics_cbs = {
	.state = mic_aics_state,
};

static int register_has_micp(void)
{
	const struct bt_has_features_param features = {
		.type = BT_HAS_HEARING_AID_TYPE_MONAURAL,
		.preset_sync_support = false,
		.independent_presets = false,
	};
	const struct bt_aics_register_param mic_aics = {
		.gain = 0,
		.mute = BT_AICS_STATE_UNMUTED,
		.gain_mode = BT_AICS_MODE_MANUAL,
		.units = 1,
		.min_gain = -60,
		.max_gain = 30,
		.type = BT_AICS_INPUT_TYPE_MICROPHONE,
		.status = true,
		.desc_writable = false,
		.description = "Microphone",
		.cb = &mic_aics_cbs,
	};
	struct bt_micp_mic_dev_register_param mic_param = {
		.cb = &mic_cbs,
	};
	int err;

	err = bt_has_register(&features);
	for (size_t i = 0; err == 0 && i < ARRAY_SIZE(preset_names); i++) {
		const struct bt_has_preset_register_param param = {
			.index = i + 1,
			.properties = BT_HAS_PROP_AVAILABLE,
			.name = preset_names[i],
			.ops = &preset_ops,
		};

		err = bt_has_preset_register(&param);
	}

	mic_param.aics_param[0] = mic_aics;
	err = err ?: bt_has_preset_active_set(1);
	err = err ?: bt_micp_mic_dev_register(&mic_param);

	return err;
}

int audio_services_init(void)
{
	const struct bt_vocs_register_param speaker = {
		.location = BT_AUDIO_LOCATION_FRONT_LEFT,
		.location_writable = false,
		.offset = 0,
		.output_desc = "Speaker",
		.desc_writable = false,
		.cb = &vocs_cbs,
	};
	struct bt_vcp_vol_rend_register_param vcp_param = {
		.step = 1,
		.mute = BT_VCP_STATE_UNMUTED,
		.volume = 100,
		.cb = &vcp_cbs,
	};
	int err;

	vcp_param.vocs_param[0] = speaker;
	err = bt_vcp_vol_rend_register(&vcp_param);

	return err != 0 ? err : register_has_micp();
}

/* The device user turns its volume wheel: the server's change counter moves, which a phone
 * connecting later has to cope with (its first write carries a stale counter)
 */
static int cmd_volume(const struct shell *sh, size_t argc, char **argv)
{
	char *end;
	const long volume = strtol(argv[1], &end, 10);
	int err;

	ARG_UNUSED(argc);

	if (*end != '\0' || volume < 0 || volume > 255) {
		return cli_err(sh, -EINVAL, "volume 0..255");
	}

	err = bt_vcp_vol_rend_set_vol((uint8_t)volume);
	if (err != 0) {
		return cli_err(sh, err, "volume change failed");
	}

	cli_ok(sh, "volume=%ld", volume);

	return 0;
}

SHELL_CMD_ARG_REGISTER(volume, NULL, "Local volume change <0..255> (the user's wheel)", cmd_volume,
		       2, 0);
```

## src/bsink.c
```c
/*
 * Copyright (c) 2026 Hubert Włodarczyk
 *
 * SPDX-License-Identifier: MPL-2.0
 */

/*
 * Broadcast (Auracast) sink: scans for a broadcast source (optionally by Broadcast Name), syncs
 * to its periodic advertising and BIG (all BISes, up to 2) and checks the audio on each BIS.
 */

#include <errno.h>
#include <stdio.h>
#include <stdlib.h>
#include <string.h>
#include <strings.h>

#include <zephyr/bluetooth/audio/audio.h>
#include <zephyr/bluetooth/audio/bap.h>
#include <zephyr/bluetooth/audio/pbp.h>
#include <zephyr/bluetooth/bluetooth.h>
#include <zephyr/bluetooth/gap.h>
#include <zephyr/bluetooth/iso.h>
#include <zephyr/bluetooth/uuid.h>
#include <zephyr/kernel.h>
#include <zephyr/logging/log.h>
#include <zephyr/shell/shell.h>
#include <zephyr/sys/byteorder.h>

#include "cli.h"
#include "dut.h"

LOG_MODULE_REGISTER(bsink, LOG_LEVEL_INF);

#define MAX_BIS       CONFIG_BT_BAP_BROADCAST_SNK_STREAM_COUNT
#define NAME_LEN      33
#define PA_SYNC_TRIES 3

enum state {
	ST_IDLE,
	ST_SCANNING,
	ST_PA_SYNCING,
	ST_PA_SYNCED,
	ST_BIG_SYNCING,
	ST_STREAMING,
};

static struct {
	enum state state;
	char target[NAME_LEN];
	uint8_t code[BT_ISO_BROADCAST_CODE_SIZE];
	bool have_code;
	uint32_t broadcast_id;
	char name[NAME_LEN];
	struct bt_le_per_adv_sync *pa_sync;
	struct bt_bap_broadcast_sink *sink;
	/* Stopped but still streaming: deleted once its BIG has stopped (stale_work) */
	struct bt_bap_broadcast_sink *stale;
	uint32_t bis_indexes;
	bool base_received;
	bool biginfo_received;
	bool encrypted;
	uint32_t want_bis; /* BIS indexes requested with 'bcast scan bis=', 0: all */
	struct bt_bap_stream streams[MAX_BIS];
	uint8_t stream_bis[MAX_BIS]; /* BIS index carried by each stream */
	struct audio_rx rx[MAX_BIS];
	uint8_t started;
	uint8_t pa_tries;
	/* From the BASE, indexed by BIS index */
	uint8_t bis_sg[BT_ISO_BIS_INDEX_MAX + 1];
	char bis_lang[BT_ISO_BIS_INDEX_MAX + 1][BT_AUDIO_LANG_SIZE + 1];
} bs;

const char *bsink_state_str(void)
{
	static const char *const names[] = {"idle",      "scanning",    "pa_syncing",
					    "pa_synced", "big_syncing", "streaming"};

	return names[bs.state];
}

static void try_big_sync(void)
{
	struct bt_bap_stream *streams[MAX_BIS];
	uint32_t bitfield = 0;
	uint8_t n = 0;
	int err;

	if (bs.state != ST_PA_SYNCED || !bs.base_received || !bs.biginfo_received ||
	    bs.sink == NULL) {
		return;
	}

	if (bs.encrypted && !bs.have_code) {
		cli_evt("dut_bcast_error", "reason=code_required");
		return;
	}

	for (uint8_t i = BT_ISO_BIS_INDEX_MIN; i <= BT_ISO_BIS_INDEX_MAX && n < MAX_BIS; i++) {
		const uint32_t bit = BT_ISO_BIS_INDEX_BIT(i);

		if ((bs.bis_indexes & bit) && (bs.want_bis == 0 || (bs.want_bis & bit))) {
			bitfield |= bit;
			bs.stream_bis[n] = i;
			streams[n] = &bs.streams[n];
			n++;
		}
	}

	if (n == 0) {
		cli_evt("dut_bcast_error", "reason=no_such_bis");
		return;
	}

	err = bt_bap_broadcast_sink_sync(bs.sink, bitfield, streams, bs.code);
	if (err != 0) {
		cli_evt("dut_bcast_error", "reason=sync_failed err=%d", err);
		return;
	}

	bs.state = ST_BIG_SYNCING;
}

/* --- Scanning --- */

struct adv_info {
	bool is_broadcast;
	uint32_t broadcast_id;
	char name[NAME_LEN];
	bool pbp;
	uint8_t pbp_features;
};

static bool parse_adv(struct bt_data *data, void *user_data)
{
	struct adv_info *info = user_data;
	struct bt_uuid_16 uuid;

	switch (data->type) {
	case BT_DATA_BROADCAST_NAME:
		memcpy(info->name, data->data, MIN(data->data_len, NAME_LEN - 1));
		break;
	case BT_DATA_SVC_DATA16:
		if (data->data_len < BT_UUID_SIZE_16 ||
		    !bt_uuid_create(&uuid.uuid, data->data, BT_UUID_SIZE_16)) {
			break;
		}

		if (bt_uuid_cmp(&uuid.uuid, BT_UUID_BROADCAST_AUDIO) == 0 &&
		    data->data_len >= BT_UUID_SIZE_16 + BT_AUDIO_BROADCAST_ID_SIZE) {
			info->is_broadcast = true;
			info->broadcast_id = sys_get_le24(data->data + BT_UUID_SIZE_16);
		} else if (bt_uuid_cmp(&uuid.uuid, BT_UUID_PBA) == 0 &&
			   data->data_len > BT_UUID_SIZE_16) {
			info->pbp = true;
			info->pbp_features = data->data[BT_UUID_SIZE_16];
		}
		break;
	default:
		break;
	}

	return true;
}

static void scan_recv(const struct bt_le_scan_recv_info *info, struct net_buf_simple *ad)
{
	struct bt_le_per_adv_sync_param param = {0};
	struct adv_info adv = {0};
	char addr[CLI_ADDR_STR_LEN];
	int err;

	if (bs.state != ST_SCANNING || info->interval == 0U) {
		return;
	}

	bt_data_parse(ad, parse_adv, &adv);
	if (!adv.is_broadcast) {
		return;
	}

	if (bs.target[0] != '\0' && strcasecmp(bs.target, adv.name) != 0) {
		return;
	}

	cli_addr_str(info->addr, addr, sizeof(addr));
	cli_evt("dut_bcast_found",
		"broadcast_id=0x%06X name=%s addr=%s sid=%u pbp=%d pbp_encrypted=%d pbp_sq=%d "
		"pbp_hq=%d rssi=%d",
		adv.broadcast_id, CLI_Q(adv.name[0] != '\0' ? adv.name : "none"), addr, info->sid,
		adv.pbp, !!(adv.pbp_features & BT_PBP_ANNOUNCEMENT_FEATURE_ENCRYPTION),
		!!(adv.pbp_features & BT_PBP_ANNOUNCEMENT_FEATURE_STANDARD_QUALITY),
		!!(adv.pbp_features & BT_PBP_ANNOUNCEMENT_FEATURE_HIGH_QUALITY), info->rssi);

	/* Scanning goes on until the sync is established: the controller needs it to receive the
	 * AUX_ADV_IND with the SyncInfo (stopped here, the sync sometimes waited forever)
	 */
	bt_addr_le_copy(&param.addr, info->addr);
	param.sid = info->sid;
	param.skip = 0;
	param.timeout = 1000; /* 10 s */
	dut_adv_hold(true);
	err = bt_le_per_adv_sync_create(&param, &bs.pa_sync);
	if (err != 0) {
		(void)bt_le_scan_stop();
		dut_adv_hold(false);
		cli_evt("dut_bcast_error", "reason=pa_sync_create err=%d", err);
		bs.state = ST_IDLE;
		return;
	}

	bs.broadcast_id = adv.broadcast_id;
	memcpy(bs.name, adv.name, sizeof(bs.name));
	bs.state = ST_PA_SYNCING;
}

static struct bt_le_scan_cb scan_cb = {
	.recv = scan_recv,
};

/* --- PA sync --- */

static void pa_synced(struct bt_le_per_adv_sync *sync, struct bt_le_per_adv_sync_synced_info *info)
{
	int err;

	ARG_UNUSED(info);

	if (sync != bs.pa_sync) {
		return;
	}

	bs.state = ST_PA_SYNCED;
	(void)bt_le_scan_stop();
	dut_adv_hold(false);
	cli_evt("dut_bcast_pa_synced", "broadcast_id=0x%06X", bs.broadcast_id);

	err = bt_bap_broadcast_sink_create(sync, bs.broadcast_id, &bs.sink);
	if (err != 0) {
		cli_evt("dut_bcast_error", "reason=sink_create err=%d", err);
	}
}

static void pa_term(struct bt_le_per_adv_sync *sync,
		    const struct bt_le_per_adv_sync_term_info *info)
{
	if (sync != bs.pa_sync) {
		return;
	}

	bs.pa_sync = NULL;
	if (bs.state == ST_PA_SYNCING) {
		/* Establishing the periodic sync can fail on a busy channel: look again (the scan
		 * is still running)
		 */
		const int scan_err = bt_le_scan_start(BT_LE_SCAN_PASSIVE, NULL);

		if (++bs.pa_tries < PA_SYNC_TRIES && (scan_err == 0 || scan_err == -EALREADY)) {
			LOG_WRN("PA sync failed (0x%02x), retrying", info->reason);
			bs.state = ST_SCANNING;
			return;
		}

		(void)bt_le_scan_stop();
		dut_adv_hold(false);
		cli_evt("dut_bcast_error", "reason=pa_sync_failed hci=0x%02x tries=%u",
			info->reason, bs.pa_tries);
		bs.state = ST_IDLE;
	} else if (bs.state != ST_STREAMING) {
		cli_evt("dut_bcast_pa_lost", "reason=0x%02x", info->reason);
	}
}

static struct bt_le_per_adv_sync_cb pa_cb = {
	.synced = pa_synced,
	.term = pa_term,
};

/* --- Broadcast sink --- */

static bool find_lang(struct bt_data *data, void *user_data)
{
	if (data->type == BT_AUDIO_METADATA_TYPE_LANG && data->data_len == BT_AUDIO_LANG_SIZE) {
		memcpy(user_data, data->data, BT_AUDIO_LANG_SIZE);
		return false;
	}

	return true;
}

/* Remembers subgroup number and language of every BIS index */
static bool base_subgroup_cb(const struct bt_bap_base_subgroup *subgroup, void *user_data)
{
	uint8_t *sg_number = user_data;
	char lang[BT_AUDIO_LANG_SIZE + 1] = "";
	uint32_t indexes = 0;
	uint8_t *meta;
	int meta_len;

	(*sg_number)++;
	meta_len = bt_bap_base_get_subgroup_codec_meta(subgroup, &meta);
	if (meta_len > 0) {
		(void)bt_audio_data_parse(meta, meta_len, find_lang, lang);
	}

	(void)bt_bap_base_subgroup_get_bis_indexes(subgroup, &indexes);
	for (uint8_t i = BT_ISO_BIS_INDEX_MIN; i <= BT_ISO_BIS_INDEX_MAX; i++) {
		if (indexes & BT_ISO_BIS_INDEX_BIT(i)) {
			bs.bis_sg[i] = *sg_number;
			memcpy(bs.bis_lang[i], lang, sizeof(lang));
		}
	}

	return true;
}

static void base_recv(struct bt_bap_broadcast_sink *sink, const struct bt_bap_base *base,
		      size_t base_size)
{
	ARG_UNUSED(sink);
	ARG_UNUSED(base_size);

	if (bs.base_received) {
		return;
	}

	if (bt_bap_base_get_bis_indexes(base, &bs.bis_indexes) != 0) {
		return;
	}

	uint8_t sg_number = 0;

	memset(bs.bis_lang, 0, sizeof(bs.bis_lang));
	(void)bt_bap_base_foreach_subgroup(base, base_subgroup_cb, &sg_number);
	bs.base_received = true;
	cli_evt("dut_bcast_base", "bis_count=%u subgroups=%d",
		sys_count_bits(&bs.bis_indexes, sizeof(bs.bis_indexes)),
		bt_bap_base_get_subgroup_count(base));
	try_big_sync();
}

static void syncable(struct bt_bap_broadcast_sink *sink, const struct bt_iso_biginfo *biginfo)
{
	ARG_UNUSED(sink);

	if (bs.biginfo_received) {
		return;
	}

	bs.biginfo_received = true;
	bs.encrypted = biginfo->encryption;
	cli_evt("dut_bcast_biginfo", "encrypted=%d bis=%u", biginfo->encryption, biginfo->num_bis);
	try_big_sync();
}

static void sink_started(struct bt_bap_broadcast_sink *sink)
{
	ARG_UNUSED(sink);
}

static bool collect_src_id(const struct bt_bap_scan_delegator_recv_state *state, void *user_data)
{
	struct {
		uint8_t ids[CONFIG_BT_BAP_SCAN_DELEGATOR_RECV_STATE_COUNT];
		size_t n;
	} *c = user_data;

	if (c->n < ARRAY_SIZE(c->ids)) {
		c->ids[c->n++] = state->src_id;
	}

	return false;
}

/* Deleting a sink keeps the BASS receive state it added; without this the next sink finds no
 * free one ("Failed to add sync as Receive State: -12")
 */
static void release_recv_states(void)
{
	struct {
		uint8_t ids[CONFIG_BT_BAP_SCAN_DELEGATOR_RECV_STATE_COUNT];
		size_t n;
	} c = {.n = 0};

	bt_bap_scan_delegator_foreach_state(collect_src_id, &c);
	for (size_t i = 0; i < c.n; i++) {
		uint32_t no_bis[BT_BAP_BASS_MAX_SUBGROUPS] = {0};

		/* A state still marked synced cannot be removed */
		(void)bt_bap_scan_delegator_set_bis_sync_state(c.ids[i], no_bis);
		(void)bt_bap_scan_delegator_set_pa_state(c.ids[i], BT_BAP_PA_STATE_NOT_SYNCED);
		(void)bt_bap_scan_delegator_rem_src(c.ids[i]);
	}
}

/* Outside the sink's callback, which is still iterating its listeners */
static void stale_delete(struct k_work *work)
{
	ARG_UNUSED(work);

	if (bs.stale != NULL && bt_bap_broadcast_sink_delete(bs.stale) == 0) {
		bs.stale = NULL;
		release_recv_states();
	}
}

static K_WORK_DEFINE(stale_work, stale_delete);

static void sink_stopped(struct bt_bap_broadcast_sink *sink, uint8_t reason)
{
	if (sink == bs.stale) {
		(void)k_work_submit(&stale_work);
		return;
	}

	cli_evt("dut_bcast_stopped", "reason=0x%02x%s", reason,
		reason == BT_HCI_ERR_TERM_DUE_TO_MIC_FAIL ? " cause=wrong_code" : "");
	if (bs.state == ST_BIG_SYNCING || bs.state == ST_STREAMING) {
		bs.state = ST_PA_SYNCED;
	}
}

static struct bt_bap_broadcast_sink_cb sink_cb = {
	.base_recv = base_recv,
	.syncable = syncable,
	.started = sink_started,
	.stopped = sink_stopped,
};

static int bis_index(const struct bt_bap_stream *stream)
{
	return stream - bs.streams;
}

static void stream_started(struct bt_bap_stream *stream)
{
	const int i = bis_index(stream);
	const uint8_t bis = bs.stream_bis[i];
	const int freq = bt_audio_codec_cfg_get_freq(stream->codec_cfg);
	char label[24];

	snprintf(label, sizeof(label), "bcast_bis%u", bis);
	(void)audio_rx_start(&bs.rx[i], stream->codec_cfg, label);

	bs.state = ST_STREAMING;
	bs.started++;
	cli_evt("dut_bcast_stream", "state=started bis=%u sg=%u sample_rate=%u octets=%d lang=%s",
		bis, bs.bis_sg[bis], freq >= 0 ? bt_audio_codec_cfg_freq_to_freq_hz(freq) : 0,
		bt_audio_codec_cfg_get_octets_per_frame(stream->codec_cfg),
		bs.bis_lang[bis][0] != '\0' ? bs.bis_lang[bis] : "none");
}

static void stream_stopped(struct bt_bap_stream *stream, uint8_t reason)
{
	const int i = bis_index(stream);

	audio_rx_stop(&bs.rx[i]);
	if (bs.started > 0) {
		bs.started--;
	}

	cli_evt("dut_bcast_stream", "state=stopped bis=%u reason=0x%02x", bs.stream_bis[i], reason);
}

static void stream_recv(struct bt_bap_stream *stream, const struct bt_iso_recv_info *info,
			struct net_buf *buf)
{
	audio_rx_frame(&bs.rx[bis_index(stream)], info, buf);
}

static struct bt_bap_stream_ops stream_ops = {
	.started = stream_started,
	.stopped = stream_stopped,
	.recv = stream_recv,
};

/* The scan delegator is required by the broadcast sink; remote requests are not supported */
static int pa_sync_req(struct bt_conn *conn,
		       const struct bt_bap_scan_delegator_recv_state *recv_state, bool past_avail,
		       uint16_t pa_interval)
{
	return -ENOTSUP;
}

static struct bt_bap_scan_delegator_cb delegator_cb = {
	.pa_sync_req = pa_sync_req,
};

int bsink_init(void)
{
	int err;

	err = bt_bap_scan_delegator_register(&delegator_cb);
	err = err ?: bt_bap_broadcast_sink_register_cb(&sink_cb);
	if (err != 0) {
		return err;
	}

	bt_le_per_adv_sync_cb_register(&pa_cb);
	bt_le_scan_cb_register(&scan_cb);
	for (size_t i = 0; i < ARRAY_SIZE(bs.streams); i++) {
		bt_bap_stream_cb_register(&bs.streams[i], &stream_ops);
	}

	return 0;
}

void bsink_reset(void)
{
	if (bs.state == ST_SCANNING || bs.state == ST_PA_SYNCING) {
		(void)bt_le_scan_stop();
	}

	if (bs.sink != NULL) {
		/* Stopping a synced BIG is asynchronous: the sink can only be deleted (which also
		 * frees its BASS receive state) after its `stopped` callback.
		 */
		(void)bt_bap_broadcast_sink_stop(bs.sink);
		if (bt_bap_broadcast_sink_delete(bs.sink) != 0) {
			/* One still stopping from before: try it once more, never lose it silently
			 */
			if (bs.stale != NULL && bt_bap_broadcast_sink_delete(bs.stale) != 0) {
				LOG_WRN("Broadcast sink %p still stopping, dropped",
					(void *)bs.stale);
			}
			bs.stale = bs.sink;
		} else {
			release_recv_states();
		}
		bs.sink = NULL;
	}

	if (bs.pa_sync != NULL) {
		(void)bt_le_per_adv_sync_delete(bs.pa_sync);
		bs.pa_sync = NULL;
	}

	dut_adv_hold(false);
	bs.state = ST_IDLE;
	bs.base_received = false;
	bs.biginfo_received = false;
	bs.started = 0;
	bs.pa_tries = 0;
}

/* --- Shell commands --- */

static int cmd_scan(const struct shell *sh, size_t argc, char **argv)
{
	const char *name = cli_kv(argc, argv, "name");
	const char *code = cli_kv(argc, argv, "code");
	const char *bis = cli_kv(argc, argv, "bis");
	uint32_t want = 0;
	int err;

	if (code != NULL && strlen(code) > BT_ISO_BROADCAST_CODE_SIZE) {
		return cli_err(sh, -EINVAL, "code max 16 characters");
	}

	/* bis=1,3: comma separated BIS indexes */
	for (const char *p = bis; p != NULL && *p != '\0';) {
		char *end;
		unsigned long idx = strtoul(p, &end, 10);

		if (end == p || idx < BT_ISO_BIS_INDEX_MIN || idx > BT_ISO_BIS_INDEX_MAX ||
		    (*end != ',' && *end != '\0')) {
			return cli_err(sh, -EINVAL, "bis=<index>[,<index>...]");
		}

		want |= BT_ISO_BIS_INDEX_BIT(idx);
		p = *end == ',' ? end + 1 : end;
	}

	bsink_reset();
	bs.want_bis = want;
	snprintf(bs.target, sizeof(bs.target), "%s", name != NULL ? name : "");
	memset(bs.code, 0, sizeof(bs.code));
	bs.have_code = code != NULL;
	if (code != NULL) {
		memcpy(bs.code, code, strlen(code));
	}

	err = bt_le_scan_start(BT_LE_SCAN_PASSIVE, NULL);
	if (err != 0) {
		return cli_err(sh, err, "scan start failed");
	}

	bs.state = ST_SCANNING;
	cli_ok(sh, "target=%s", CLI_Q(bs.target[0] != '\0' ? bs.target : "any"));

	return 0;
}

static int cmd_stop(const struct shell *sh, size_t argc, char **argv)
{
	ARG_UNUSED(argc);
	ARG_UNUSED(argv);

	bsink_reset();
	cli_ok(sh, NULL);

	return 0;
}

static int cmd_status(const struct shell *sh, size_t argc, char **argv)
{
	ARG_UNUSED(argc);
	ARG_UNUSED(argv);

	cli_ok(sh, "state=%s broadcast_id=0x%06X name=%s encrypted=%d streams=%u",
	       bsink_state_str(), bs.broadcast_id, CLI_Q(bs.name[0] != '\0' ? bs.name : "none"),
	       bs.encrypted, bs.started);

	return 0;
}

SHELL_STATIC_SUBCMD_SET_CREATE(
	bcast_cmds,
	SHELL_CMD_ARG(scan, NULL, "[name=<broadcast name>] [code=<broadcast code>] [bis=1,3]",
		      cmd_scan, 1, 3),
	SHELL_CMD_ARG(stop, NULL, "Leave the broadcast", cmd_stop, 1, 0),
	SHELL_CMD_ARG(status, NULL, "Broadcast sink state", cmd_status, 1, 0),
	SHELL_SUBCMD_SET_END);

SHELL_CMD_REGISTER(bcast, &bcast_cmds, "Broadcast sink", NULL);
```

## src/dut.h
```c
/*
 * Copyright (c) 2026 Hubert Włodarczyk
 *
 * SPDX-License-Identifier: MPL-2.0
 */

#ifndef DUT_H_
#define DUT_H_

#include <stdbool.h>
#include <stdint.h>

#include <lc3.h>

#include <zephyr/bluetooth/audio/audio.h>
#include <zephyr/bluetooth/conn.h>
#include <zephyr/bluetooth/iso.h>
#include <zephyr/net_buf.h>

#define DUT_VERSION "0.1.0"

#define DUT_SINK_CONTEXTS                                                                          \
	(BT_AUDIO_CONTEXT_TYPE_UNSPECIFIED | BT_AUDIO_CONTEXT_TYPE_CONVERSATIONAL |                \
	 BT_AUDIO_CONTEXT_TYPE_MEDIA | BT_AUDIO_CONTEXT_TYPE_RINGTONE |                            \
	 BT_AUDIO_CONTEXT_TYPE_ALERTS | BT_AUDIO_CONTEXT_TYPE_NOTIFICATIONS |                      \
	 BT_AUDIO_CONTEXT_TYPE_LIVE)
#define DUT_SOURCE_CONTEXTS                                                                        \
	(BT_AUDIO_CONTEXT_TYPE_UNSPECIFIED | BT_AUDIO_CONTEXT_TYPE_CONVERSATIONAL)

/* Decodes received LC3 frames and reports tone frequency and level once per second */
struct audio_rx {
	char label[24];
	lc3_decoder_t decoder;
	uint32_t sr_hz;    /* real sampling rate */
	uint32_t coded_hz; /* rate the LC3 frames are coded at (44.1 kHz: 48 kHz) */
	int samples;       /* per frame */
	uint32_t frame_us; /* real frame duration */
	uint16_t octets;
	bool active;
	uint32_t frames;
	uint32_t active_frames;
	uint32_t lost;
	uint32_t clipped;      /* decoded samples at full scale: the tone was clipped */
	uint32_t crossings;    /* half periods counted inside frames */
	uint32_t span_samples; /* samples spanned by those half periods */
	int8_t sign;
	int16_t peak;
	uint32_t total_frames;
	int32_t last_seq; /* -1: none yet */

	/* Decoder memory for the largest configuration (10 ms, 48 kHz) */
	LC3_DECODER_MEM_T(10000, 48000) decoder_mem;
};

int audio_rx_start(struct audio_rx *rx, const struct bt_audio_codec_cfg *cfg, const char *label);
void audio_rx_stop(struct audio_rx *rx);
void audio_rx_frame(struct audio_rx *rx, const struct bt_iso_recv_info *info,
		    const struct net_buf *buf);

const char *ctx_str(uint16_t ctx);

int unicast_init(void);
uint8_t unicast_stream_count(void);

/* Pairing callbacks, IO test double, bond commands (pairing.c) */
int pairing_init(void);
int dut_bond_count(void);

/* Volume renderer, HAS and MICP servers (audio_services.c) */
int audio_services_init(void);

/* Call and media control clients, the device buttons (ctrl.c) */
int ctrl_init(void);
void ctrl_on_secure(struct bt_conn *conn);
void ctrl_on_disconnected(struct bt_conn *conn);

/*
 * Pauses connectable advertising while a broadcast's periodic advertising sync is established.
 * The Zephyr controller lets the AUX event of its own advertising preempt the sync's receive
 * window; with an advertising interval that divides the PA interval (30 ms vs. 60 ms, the BAP
 * defaults) that happens at every PA event on an unlucky phase and the sync fails (0x3e).
 */
void dut_adv_hold(bool hold);

int bsink_init(void);
void bsink_reset(void);
const char *bsink_state_str(void);

#endif /* DUT_H_ */
```
